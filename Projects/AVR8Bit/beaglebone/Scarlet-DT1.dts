/dts-v1/;
/plugin/;

/ {
    /* Generated by Scarlet. */
    compatible = "ti,beaglebone", "ti,beaglebone-black";
    part-number = "scarlet-pins";
    version = "00A0";
    
    exclusive-use =
        "i2c1",
        "P9.17",
        "P9.26";
    
    fragment@3 {
        target = <&am33xx_pinmux>;
        __overlay__ {
            bbb_i2c1_pins: pinmux_bbb_i2c1_pins {
                pinctrl-single,pins = <
                    0x15C 0x72
                    0x180 0x73
                >;
            };
        };
    };
    
    fragment@20 {
        target = <&i2c1>;
        __overlay__ {
            status = "okay";
            pinctrl-names = "default";
            pinctrl-0 = <&bbb_i2c1_pins>;
            clock-frequency = <100000>;
            #address-cells = <1>;
            #size-cells = <0>;
        };
    };
    
};
