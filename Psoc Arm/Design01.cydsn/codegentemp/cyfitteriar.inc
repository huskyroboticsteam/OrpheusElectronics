;
; File Name: cyfitteriar.inc
; 
; PSoC Creator  4.2
;
; Description:
; 
;
;-------------------------------------------------------------------------------
; Copyright (c) 2007-2018 Cypress Semiconductor.  All rights reserved.
; You may use this file only in accordance with the license, terms, conditions, 
; disclaimers, and limitations in the end user license agreement accompanying 
; the software package with which this file was provided.
;-------------------------------------------------------------------------------

#ifndef INCLUDED_CYFITTERIAR_INC
#define INCLUDED_CYFITTERIAR_INC
    INCLUDE cydeviceiar_trm.inc

/* Clock_PWM */
Clock_PWM__CTRL_REGISTER EQU CYREG_PERI_PCLK_CTL18
Clock_PWM__DIV_ID EQU 0x00000040
Clock_PWM__DIV_REGISTER EQU CYREG_PERI_DIV_16_CTL0
Clock_PWM__PA_DIV_ID EQU 0x000000FF

/* PWM_Motor */
PWM_Motor_cy_m0s8_tcpwm_1__CC EQU CYREG_TCPWM_CNT7_CC
PWM_Motor_cy_m0s8_tcpwm_1__CC_BUFF EQU CYREG_TCPWM_CNT7_CC_BUFF
PWM_Motor_cy_m0s8_tcpwm_1__COUNTER EQU CYREG_TCPWM_CNT7_COUNTER
PWM_Motor_cy_m0s8_tcpwm_1__CTRL EQU CYREG_TCPWM_CNT7_CTRL
PWM_Motor_cy_m0s8_tcpwm_1__INTR EQU CYREG_TCPWM_CNT7_INTR
PWM_Motor_cy_m0s8_tcpwm_1__INTR_MASK EQU CYREG_TCPWM_CNT7_INTR_MASK
PWM_Motor_cy_m0s8_tcpwm_1__INTR_MASKED EQU CYREG_TCPWM_CNT7_INTR_MASKED
PWM_Motor_cy_m0s8_tcpwm_1__INTR_SET EQU CYREG_TCPWM_CNT7_INTR_SET
PWM_Motor_cy_m0s8_tcpwm_1__PERIOD EQU CYREG_TCPWM_CNT7_PERIOD
PWM_Motor_cy_m0s8_tcpwm_1__PERIOD_BUFF EQU CYREG_TCPWM_CNT7_PERIOD_BUFF
PWM_Motor_cy_m0s8_tcpwm_1__STATUS EQU CYREG_TCPWM_CNT7_STATUS
PWM_Motor_cy_m0s8_tcpwm_1__TCPWM_CMD EQU CYREG_TCPWM_CMD
PWM_Motor_cy_m0s8_tcpwm_1__TCPWM_CMDCAPTURE_MASK EQU 0x80
PWM_Motor_cy_m0s8_tcpwm_1__TCPWM_CMDCAPTURE_SHIFT EQU 7
PWM_Motor_cy_m0s8_tcpwm_1__TCPWM_CMDRELOAD_MASK EQU 0x8000
PWM_Motor_cy_m0s8_tcpwm_1__TCPWM_CMDRELOAD_SHIFT EQU 15
PWM_Motor_cy_m0s8_tcpwm_1__TCPWM_CMDSTART_MASK EQU 0x80000000
PWM_Motor_cy_m0s8_tcpwm_1__TCPWM_CMDSTART_SHIFT EQU 31
PWM_Motor_cy_m0s8_tcpwm_1__TCPWM_CMDSTOP_MASK EQU 0x800000
PWM_Motor_cy_m0s8_tcpwm_1__TCPWM_CMDSTOP_SHIFT EQU 23
PWM_Motor_cy_m0s8_tcpwm_1__TCPWM_CTRL EQU CYREG_TCPWM_CTRL
PWM_Motor_cy_m0s8_tcpwm_1__TCPWM_CTRL_MASK EQU 0x80
PWM_Motor_cy_m0s8_tcpwm_1__TCPWM_CTRL_SHIFT EQU 7
PWM_Motor_cy_m0s8_tcpwm_1__TCPWM_INTR_CAUSE EQU CYREG_TCPWM_INTR_CAUSE
PWM_Motor_cy_m0s8_tcpwm_1__TCPWM_INTR_CAUSE_MASK EQU 0x80
PWM_Motor_cy_m0s8_tcpwm_1__TCPWM_INTR_CAUSE_SHIFT EQU 7
PWM_Motor_cy_m0s8_tcpwm_1__TCPWM_NUMBER EQU 7
PWM_Motor_cy_m0s8_tcpwm_1__TR_CTRL0 EQU CYREG_TCPWM_CNT7_TR_CTRL0
PWM_Motor_cy_m0s8_tcpwm_1__TR_CTRL1 EQU CYREG_TCPWM_CNT7_TR_CTRL1
PWM_Motor_cy_m0s8_tcpwm_1__TR_CTRL2 EQU CYREG_TCPWM_CNT7_TR_CTRL2

/* Pin_Motor */
Pin_Motor__0__DR EQU CYREG_GPIO_PRT1_DR
Pin_Motor__0__DR_CLR EQU CYREG_GPIO_PRT1_DR_CLR
Pin_Motor__0__DR_INV EQU CYREG_GPIO_PRT1_DR_INV
Pin_Motor__0__DR_SET EQU CYREG_GPIO_PRT1_DR_SET
Pin_Motor__0__HSIOM EQU CYREG_HSIOM_PORT_SEL1
Pin_Motor__0__HSIOM_MASK EQU 0x0F000000
Pin_Motor__0__HSIOM_SHIFT EQU 24
Pin_Motor__0__INTCFG EQU CYREG_GPIO_PRT1_INTR_CFG
Pin_Motor__0__INTR EQU CYREG_GPIO_PRT1_INTR
Pin_Motor__0__INTR_CFG EQU CYREG_GPIO_PRT1_INTR_CFG
Pin_Motor__0__INTSTAT EQU CYREG_GPIO_PRT1_INTR
Pin_Motor__0__MASK EQU 0x40
Pin_Motor__0__OUT_SEL EQU CYREG_UDB_PA1_CFG10
Pin_Motor__0__OUT_SEL_SHIFT EQU 12
Pin_Motor__0__OUT_SEL_VAL EQU -1
Pin_Motor__0__PA__CFG0 EQU CYREG_UDB_PA1_CFG0
Pin_Motor__0__PA__CFG1 EQU CYREG_UDB_PA1_CFG1
Pin_Motor__0__PA__CFG10 EQU CYREG_UDB_PA1_CFG10
Pin_Motor__0__PA__CFG11 EQU CYREG_UDB_PA1_CFG11
Pin_Motor__0__PA__CFG12 EQU CYREG_UDB_PA1_CFG12
Pin_Motor__0__PA__CFG13 EQU CYREG_UDB_PA1_CFG13
Pin_Motor__0__PA__CFG14 EQU CYREG_UDB_PA1_CFG14
Pin_Motor__0__PA__CFG2 EQU CYREG_UDB_PA1_CFG2
Pin_Motor__0__PA__CFG3 EQU CYREG_UDB_PA1_CFG3
Pin_Motor__0__PA__CFG4 EQU CYREG_UDB_PA1_CFG4
Pin_Motor__0__PA__CFG5 EQU CYREG_UDB_PA1_CFG5
Pin_Motor__0__PA__CFG6 EQU CYREG_UDB_PA1_CFG6
Pin_Motor__0__PA__CFG7 EQU CYREG_UDB_PA1_CFG7
Pin_Motor__0__PA__CFG8 EQU CYREG_UDB_PA1_CFG8
Pin_Motor__0__PA__CFG9 EQU CYREG_UDB_PA1_CFG9
Pin_Motor__0__PC EQU CYREG_GPIO_PRT1_PC
Pin_Motor__0__PC2 EQU CYREG_GPIO_PRT1_PC2
Pin_Motor__0__PORT EQU 1
Pin_Motor__0__PS EQU CYREG_GPIO_PRT1_PS
Pin_Motor__0__SHIFT EQU 6
Pin_Motor__DR EQU CYREG_GPIO_PRT1_DR
Pin_Motor__DR_CLR EQU CYREG_GPIO_PRT1_DR_CLR
Pin_Motor__DR_INV EQU CYREG_GPIO_PRT1_DR_INV
Pin_Motor__DR_SET EQU CYREG_GPIO_PRT1_DR_SET
Pin_Motor__INTCFG EQU CYREG_GPIO_PRT1_INTR_CFG
Pin_Motor__INTR EQU CYREG_GPIO_PRT1_INTR
Pin_Motor__INTR_CFG EQU CYREG_GPIO_PRT1_INTR_CFG
Pin_Motor__INTSTAT EQU CYREG_GPIO_PRT1_INTR
Pin_Motor__MASK EQU 0x40
Pin_Motor__PA__CFG0 EQU CYREG_UDB_PA1_CFG0
Pin_Motor__PA__CFG1 EQU CYREG_UDB_PA1_CFG1
Pin_Motor__PA__CFG10 EQU CYREG_UDB_PA1_CFG10
Pin_Motor__PA__CFG11 EQU CYREG_UDB_PA1_CFG11
Pin_Motor__PA__CFG12 EQU CYREG_UDB_PA1_CFG12
Pin_Motor__PA__CFG13 EQU CYREG_UDB_PA1_CFG13
Pin_Motor__PA__CFG14 EQU CYREG_UDB_PA1_CFG14
Pin_Motor__PA__CFG2 EQU CYREG_UDB_PA1_CFG2
Pin_Motor__PA__CFG3 EQU CYREG_UDB_PA1_CFG3
Pin_Motor__PA__CFG4 EQU CYREG_UDB_PA1_CFG4
Pin_Motor__PA__CFG5 EQU CYREG_UDB_PA1_CFG5
Pin_Motor__PA__CFG6 EQU CYREG_UDB_PA1_CFG6
Pin_Motor__PA__CFG7 EQU CYREG_UDB_PA1_CFG7
Pin_Motor__PA__CFG8 EQU CYREG_UDB_PA1_CFG8
Pin_Motor__PA__CFG9 EQU CYREG_UDB_PA1_CFG9
Pin_Motor__PC EQU CYREG_GPIO_PRT1_PC
Pin_Motor__PC2 EQU CYREG_GPIO_PRT1_PC2
Pin_Motor__PORT EQU 1
Pin_Motor__PS EQU CYREG_GPIO_PRT1_PS
Pin_Motor__SHIFT EQU 6

/* Pin_debug */
Pin_debug__0__DR EQU CYREG_GPIO_PRT5_DR
Pin_debug__0__DR_CLR EQU CYREG_GPIO_PRT5_DR_CLR
Pin_debug__0__DR_INV EQU CYREG_GPIO_PRT5_DR_INV
Pin_debug__0__DR_SET EQU CYREG_GPIO_PRT5_DR_SET
Pin_debug__0__HSIOM EQU CYREG_HSIOM_PORT_SEL5
Pin_debug__0__HSIOM_MASK EQU 0x0000F000
Pin_debug__0__HSIOM_SHIFT EQU 12
Pin_debug__0__INTCFG EQU CYREG_GPIO_PRT5_INTR_CFG
Pin_debug__0__INTR EQU CYREG_GPIO_PRT5_INTR
Pin_debug__0__INTR_CFG EQU CYREG_GPIO_PRT5_INTR_CFG
Pin_debug__0__INTSTAT EQU CYREG_GPIO_PRT5_INTR
Pin_debug__0__MASK EQU 0x08
Pin_debug__0__PA__CFG0 EQU CYREG_UDB_PA0_CFG0
Pin_debug__0__PA__CFG1 EQU CYREG_UDB_PA0_CFG1
Pin_debug__0__PA__CFG10 EQU CYREG_UDB_PA0_CFG10
Pin_debug__0__PA__CFG11 EQU CYREG_UDB_PA0_CFG11
Pin_debug__0__PA__CFG12 EQU CYREG_UDB_PA0_CFG12
Pin_debug__0__PA__CFG13 EQU CYREG_UDB_PA0_CFG13
Pin_debug__0__PA__CFG14 EQU CYREG_UDB_PA0_CFG14
Pin_debug__0__PA__CFG2 EQU CYREG_UDB_PA0_CFG2
Pin_debug__0__PA__CFG3 EQU CYREG_UDB_PA0_CFG3
Pin_debug__0__PA__CFG4 EQU CYREG_UDB_PA0_CFG4
Pin_debug__0__PA__CFG5 EQU CYREG_UDB_PA0_CFG5
Pin_debug__0__PA__CFG6 EQU CYREG_UDB_PA0_CFG6
Pin_debug__0__PA__CFG7 EQU CYREG_UDB_PA0_CFG7
Pin_debug__0__PA__CFG8 EQU CYREG_UDB_PA0_CFG8
Pin_debug__0__PA__CFG9 EQU CYREG_UDB_PA0_CFG9
Pin_debug__0__PC EQU CYREG_GPIO_PRT5_PC
Pin_debug__0__PC2 EQU CYREG_GPIO_PRT5_PC2
Pin_debug__0__PORT EQU 5
Pin_debug__0__PS EQU CYREG_GPIO_PRT5_PS
Pin_debug__0__SHIFT EQU 3
Pin_debug__DR EQU CYREG_GPIO_PRT5_DR
Pin_debug__DR_CLR EQU CYREG_GPIO_PRT5_DR_CLR
Pin_debug__DR_INV EQU CYREG_GPIO_PRT5_DR_INV
Pin_debug__DR_SET EQU CYREG_GPIO_PRT5_DR_SET
Pin_debug__INTCFG EQU CYREG_GPIO_PRT5_INTR_CFG
Pin_debug__INTR EQU CYREG_GPIO_PRT5_INTR
Pin_debug__INTR_CFG EQU CYREG_GPIO_PRT5_INTR_CFG
Pin_debug__INTSTAT EQU CYREG_GPIO_PRT5_INTR
Pin_debug__MASK EQU 0x08
Pin_debug__PA__CFG0 EQU CYREG_UDB_PA0_CFG0
Pin_debug__PA__CFG1 EQU CYREG_UDB_PA0_CFG1
Pin_debug__PA__CFG10 EQU CYREG_UDB_PA0_CFG10
Pin_debug__PA__CFG11 EQU CYREG_UDB_PA0_CFG11
Pin_debug__PA__CFG12 EQU CYREG_UDB_PA0_CFG12
Pin_debug__PA__CFG13 EQU CYREG_UDB_PA0_CFG13
Pin_debug__PA__CFG14 EQU CYREG_UDB_PA0_CFG14
Pin_debug__PA__CFG2 EQU CYREG_UDB_PA0_CFG2
Pin_debug__PA__CFG3 EQU CYREG_UDB_PA0_CFG3
Pin_debug__PA__CFG4 EQU CYREG_UDB_PA0_CFG4
Pin_debug__PA__CFG5 EQU CYREG_UDB_PA0_CFG5
Pin_debug__PA__CFG6 EQU CYREG_UDB_PA0_CFG6
Pin_debug__PA__CFG7 EQU CYREG_UDB_PA0_CFG7
Pin_debug__PA__CFG8 EQU CYREG_UDB_PA0_CFG8
Pin_debug__PA__CFG9 EQU CYREG_UDB_PA0_CFG9
Pin_debug__PC EQU CYREG_GPIO_PRT5_PC
Pin_debug__PC2 EQU CYREG_GPIO_PRT5_PC2
Pin_debug__PORT EQU 5
Pin_debug__PS EQU CYREG_GPIO_PRT5_PS
Pin_debug__SHIFT EQU 3

/* Pin_Limit_1 */
Pin_Limit_1__0__DR EQU CYREG_GPIO_PRT0_DR
Pin_Limit_1__0__DR_CLR EQU CYREG_GPIO_PRT0_DR_CLR
Pin_Limit_1__0__DR_INV EQU CYREG_GPIO_PRT0_DR_INV
Pin_Limit_1__0__DR_SET EQU CYREG_GPIO_PRT0_DR_SET
Pin_Limit_1__0__HSIOM EQU CYREG_HSIOM_PORT_SEL0
Pin_Limit_1__0__HSIOM_MASK EQU 0xF0000000
Pin_Limit_1__0__HSIOM_SHIFT EQU 28
Pin_Limit_1__0__INTCFG EQU CYREG_GPIO_PRT0_INTR_CFG
Pin_Limit_1__0__INTR EQU CYREG_GPIO_PRT0_INTR
Pin_Limit_1__0__INTR_CFG EQU CYREG_GPIO_PRT0_INTR_CFG
Pin_Limit_1__0__INTSTAT EQU CYREG_GPIO_PRT0_INTR
Pin_Limit_1__0__MASK EQU 0x80
Pin_Limit_1__0__PA__CFG0 EQU CYREG_UDB_PA4_CFG0
Pin_Limit_1__0__PA__CFG1 EQU CYREG_UDB_PA4_CFG1
Pin_Limit_1__0__PA__CFG10 EQU CYREG_UDB_PA4_CFG10
Pin_Limit_1__0__PA__CFG11 EQU CYREG_UDB_PA4_CFG11
Pin_Limit_1__0__PA__CFG12 EQU CYREG_UDB_PA4_CFG12
Pin_Limit_1__0__PA__CFG13 EQU CYREG_UDB_PA4_CFG13
Pin_Limit_1__0__PA__CFG14 EQU CYREG_UDB_PA4_CFG14
Pin_Limit_1__0__PA__CFG2 EQU CYREG_UDB_PA4_CFG2
Pin_Limit_1__0__PA__CFG3 EQU CYREG_UDB_PA4_CFG3
Pin_Limit_1__0__PA__CFG4 EQU CYREG_UDB_PA4_CFG4
Pin_Limit_1__0__PA__CFG5 EQU CYREG_UDB_PA4_CFG5
Pin_Limit_1__0__PA__CFG6 EQU CYREG_UDB_PA4_CFG6
Pin_Limit_1__0__PA__CFG7 EQU CYREG_UDB_PA4_CFG7
Pin_Limit_1__0__PA__CFG8 EQU CYREG_UDB_PA4_CFG8
Pin_Limit_1__0__PA__CFG9 EQU CYREG_UDB_PA4_CFG9
Pin_Limit_1__0__PC EQU CYREG_GPIO_PRT0_PC
Pin_Limit_1__0__PC2 EQU CYREG_GPIO_PRT0_PC2
Pin_Limit_1__0__PORT EQU 0
Pin_Limit_1__0__PS EQU CYREG_GPIO_PRT0_PS
Pin_Limit_1__0__SHIFT EQU 7
Pin_Limit_1__DR EQU CYREG_GPIO_PRT0_DR
Pin_Limit_1__DR_CLR EQU CYREG_GPIO_PRT0_DR_CLR
Pin_Limit_1__DR_INV EQU CYREG_GPIO_PRT0_DR_INV
Pin_Limit_1__DR_SET EQU CYREG_GPIO_PRT0_DR_SET
Pin_Limit_1__INTCFG EQU CYREG_GPIO_PRT0_INTR_CFG
Pin_Limit_1__INTR EQU CYREG_GPIO_PRT0_INTR
Pin_Limit_1__INTR_CFG EQU CYREG_GPIO_PRT0_INTR_CFG
Pin_Limit_1__INTSTAT EQU CYREG_GPIO_PRT0_INTR
Pin_Limit_1__MASK EQU 0x80
Pin_Limit_1__PA__CFG0 EQU CYREG_UDB_PA4_CFG0
Pin_Limit_1__PA__CFG1 EQU CYREG_UDB_PA4_CFG1
Pin_Limit_1__PA__CFG10 EQU CYREG_UDB_PA4_CFG10
Pin_Limit_1__PA__CFG11 EQU CYREG_UDB_PA4_CFG11
Pin_Limit_1__PA__CFG12 EQU CYREG_UDB_PA4_CFG12
Pin_Limit_1__PA__CFG13 EQU CYREG_UDB_PA4_CFG13
Pin_Limit_1__PA__CFG14 EQU CYREG_UDB_PA4_CFG14
Pin_Limit_1__PA__CFG2 EQU CYREG_UDB_PA4_CFG2
Pin_Limit_1__PA__CFG3 EQU CYREG_UDB_PA4_CFG3
Pin_Limit_1__PA__CFG4 EQU CYREG_UDB_PA4_CFG4
Pin_Limit_1__PA__CFG5 EQU CYREG_UDB_PA4_CFG5
Pin_Limit_1__PA__CFG6 EQU CYREG_UDB_PA4_CFG6
Pin_Limit_1__PA__CFG7 EQU CYREG_UDB_PA4_CFG7
Pin_Limit_1__PA__CFG8 EQU CYREG_UDB_PA4_CFG8
Pin_Limit_1__PA__CFG9 EQU CYREG_UDB_PA4_CFG9
Pin_Limit_1__PC EQU CYREG_GPIO_PRT0_PC
Pin_Limit_1__PC2 EQU CYREG_GPIO_PRT0_PC2
Pin_Limit_1__PORT EQU 0
Pin_Limit_1__PS EQU CYREG_GPIO_PRT0_PS
Pin_Limit_1__SHIFT EQU 7
Pin_Limit_1__SNAP EQU CYREG_GPIO_PRT0_INTR

/* isr_Limit_1 */
isr_Limit_1__INTC_CLR_EN_REG EQU CYREG_CM0_ICER
isr_Limit_1__INTC_CLR_PD_REG EQU CYREG_CM0_ICPR
isr_Limit_1__INTC_MASK EQU 0x01
isr_Limit_1__INTC_NUMBER EQU 0
isr_Limit_1__INTC_PRIOR_MASK EQU 0xC0
isr_Limit_1__INTC_PRIOR_NUM EQU 3
isr_Limit_1__INTC_PRIOR_REG EQU CYREG_CM0_IPR0
isr_Limit_1__INTC_SET_EN_REG EQU CYREG_CM0_ISER
isr_Limit_1__INTC_SET_PD_REG EQU CYREG_CM0_ISPR

/* Pin_Direction */
Pin_Direction__0__DR EQU CYREG_GPIO_PRT1_DR
Pin_Direction__0__DR_CLR EQU CYREG_GPIO_PRT1_DR_CLR
Pin_Direction__0__DR_INV EQU CYREG_GPIO_PRT1_DR_INV
Pin_Direction__0__DR_SET EQU CYREG_GPIO_PRT1_DR_SET
Pin_Direction__0__HSIOM EQU CYREG_HSIOM_PORT_SEL1
Pin_Direction__0__HSIOM_MASK EQU 0x000F0000
Pin_Direction__0__HSIOM_SHIFT EQU 16
Pin_Direction__0__INTCFG EQU CYREG_GPIO_PRT1_INTR_CFG
Pin_Direction__0__INTR EQU CYREG_GPIO_PRT1_INTR
Pin_Direction__0__INTR_CFG EQU CYREG_GPIO_PRT1_INTR_CFG
Pin_Direction__0__INTSTAT EQU CYREG_GPIO_PRT1_INTR
Pin_Direction__0__MASK EQU 0x10
Pin_Direction__0__PA__CFG0 EQU CYREG_UDB_PA1_CFG0
Pin_Direction__0__PA__CFG1 EQU CYREG_UDB_PA1_CFG1
Pin_Direction__0__PA__CFG10 EQU CYREG_UDB_PA1_CFG10
Pin_Direction__0__PA__CFG11 EQU CYREG_UDB_PA1_CFG11
Pin_Direction__0__PA__CFG12 EQU CYREG_UDB_PA1_CFG12
Pin_Direction__0__PA__CFG13 EQU CYREG_UDB_PA1_CFG13
Pin_Direction__0__PA__CFG14 EQU CYREG_UDB_PA1_CFG14
Pin_Direction__0__PA__CFG2 EQU CYREG_UDB_PA1_CFG2
Pin_Direction__0__PA__CFG3 EQU CYREG_UDB_PA1_CFG3
Pin_Direction__0__PA__CFG4 EQU CYREG_UDB_PA1_CFG4
Pin_Direction__0__PA__CFG5 EQU CYREG_UDB_PA1_CFG5
Pin_Direction__0__PA__CFG6 EQU CYREG_UDB_PA1_CFG6
Pin_Direction__0__PA__CFG7 EQU CYREG_UDB_PA1_CFG7
Pin_Direction__0__PA__CFG8 EQU CYREG_UDB_PA1_CFG8
Pin_Direction__0__PA__CFG9 EQU CYREG_UDB_PA1_CFG9
Pin_Direction__0__PC EQU CYREG_GPIO_PRT1_PC
Pin_Direction__0__PC2 EQU CYREG_GPIO_PRT1_PC2
Pin_Direction__0__PORT EQU 1
Pin_Direction__0__PS EQU CYREG_GPIO_PRT1_PS
Pin_Direction__0__SHIFT EQU 4
Pin_Direction__DR EQU CYREG_GPIO_PRT1_DR
Pin_Direction__DR_CLR EQU CYREG_GPIO_PRT1_DR_CLR
Pin_Direction__DR_INV EQU CYREG_GPIO_PRT1_DR_INV
Pin_Direction__DR_SET EQU CYREG_GPIO_PRT1_DR_SET
Pin_Direction__INTCFG EQU CYREG_GPIO_PRT1_INTR_CFG
Pin_Direction__INTR EQU CYREG_GPIO_PRT1_INTR
Pin_Direction__INTR_CFG EQU CYREG_GPIO_PRT1_INTR_CFG
Pin_Direction__INTSTAT EQU CYREG_GPIO_PRT1_INTR
Pin_Direction__MASK EQU 0x10
Pin_Direction__PA__CFG0 EQU CYREG_UDB_PA1_CFG0
Pin_Direction__PA__CFG1 EQU CYREG_UDB_PA1_CFG1
Pin_Direction__PA__CFG10 EQU CYREG_UDB_PA1_CFG10
Pin_Direction__PA__CFG11 EQU CYREG_UDB_PA1_CFG11
Pin_Direction__PA__CFG12 EQU CYREG_UDB_PA1_CFG12
Pin_Direction__PA__CFG13 EQU CYREG_UDB_PA1_CFG13
Pin_Direction__PA__CFG14 EQU CYREG_UDB_PA1_CFG14
Pin_Direction__PA__CFG2 EQU CYREG_UDB_PA1_CFG2
Pin_Direction__PA__CFG3 EQU CYREG_UDB_PA1_CFG3
Pin_Direction__PA__CFG4 EQU CYREG_UDB_PA1_CFG4
Pin_Direction__PA__CFG5 EQU CYREG_UDB_PA1_CFG5
Pin_Direction__PA__CFG6 EQU CYREG_UDB_PA1_CFG6
Pin_Direction__PA__CFG7 EQU CYREG_UDB_PA1_CFG7
Pin_Direction__PA__CFG8 EQU CYREG_UDB_PA1_CFG8
Pin_Direction__PA__CFG9 EQU CYREG_UDB_PA1_CFG9
Pin_Direction__PC EQU CYREG_GPIO_PRT1_PC
Pin_Direction__PC2 EQU CYREG_GPIO_PRT1_PC2
Pin_Direction__PORT EQU 1
Pin_Direction__PS EQU CYREG_GPIO_PRT1_PS
Pin_Direction__SHIFT EQU 4

/* Miscellaneous */
CYDEV_BCLK__HFCLK__HZ EQU 48000000
CYDEV_BCLK__HFCLK__KHZ EQU 48000
CYDEV_BCLK__HFCLK__MHZ EQU 48
CYDEV_BCLK__SYSCLK__HZ EQU 48000000
CYDEV_BCLK__SYSCLK__KHZ EQU 48000
CYDEV_BCLK__SYSCLK__MHZ EQU 48
CYDEV_CHIP_DIE_LEOPARD EQU 1
CYDEV_CHIP_DIE_PSOC4A EQU 18
CYDEV_CHIP_DIE_PSOC5LP EQU 2
CYDEV_CHIP_DIE_PSOC5TM EQU 3
CYDEV_CHIP_DIE_TMA4 EQU 4
CYDEV_CHIP_DIE_UNKNOWN EQU 0
CYDEV_CHIP_FAMILY_FM0P EQU 5
CYDEV_CHIP_FAMILY_FM3 EQU 6
CYDEV_CHIP_FAMILY_FM4 EQU 7
CYDEV_CHIP_FAMILY_PSOC3 EQU 1
CYDEV_CHIP_FAMILY_PSOC4 EQU 2
CYDEV_CHIP_FAMILY_PSOC5 EQU 3
CYDEV_CHIP_FAMILY_PSOC6 EQU 4
CYDEV_CHIP_FAMILY_UNKNOWN EQU 0
CYDEV_CHIP_FAMILY_USED EQU CYDEV_CHIP_FAMILY_PSOC4
CYDEV_CHIP_JTAG_ID EQU 0x101311A0
CYDEV_CHIP_MEMBER_3A EQU 1
CYDEV_CHIP_MEMBER_4A EQU 18
CYDEV_CHIP_MEMBER_4D EQU 13
CYDEV_CHIP_MEMBER_4E EQU 6
CYDEV_CHIP_MEMBER_4F EQU 19
CYDEV_CHIP_MEMBER_4G EQU 4
CYDEV_CHIP_MEMBER_4H EQU 17
CYDEV_CHIP_MEMBER_4I EQU 23
CYDEV_CHIP_MEMBER_4J EQU 14
CYDEV_CHIP_MEMBER_4K EQU 15
CYDEV_CHIP_MEMBER_4L EQU 22
CYDEV_CHIP_MEMBER_4M EQU 21
CYDEV_CHIP_MEMBER_4N EQU 10
CYDEV_CHIP_MEMBER_4O EQU 7
CYDEV_CHIP_MEMBER_4P EQU 20
CYDEV_CHIP_MEMBER_4Q EQU 12
CYDEV_CHIP_MEMBER_4R EQU 8
CYDEV_CHIP_MEMBER_4S EQU 11
CYDEV_CHIP_MEMBER_4T EQU 9
CYDEV_CHIP_MEMBER_4U EQU 5
CYDEV_CHIP_MEMBER_4V EQU 16
CYDEV_CHIP_MEMBER_5A EQU 3
CYDEV_CHIP_MEMBER_5B EQU 2
CYDEV_CHIP_MEMBER_6A EQU 24
CYDEV_CHIP_MEMBER_FM3 EQU 28
CYDEV_CHIP_MEMBER_FM4 EQU 29
CYDEV_CHIP_MEMBER_PDL_FM0P_TYPE1 EQU 25
CYDEV_CHIP_MEMBER_PDL_FM0P_TYPE2 EQU 26
CYDEV_CHIP_MEMBER_PDL_FM0P_TYPE3 EQU 27
CYDEV_CHIP_MEMBER_UNKNOWN EQU 0
CYDEV_CHIP_MEMBER_USED EQU CYDEV_CHIP_MEMBER_4L
CYDEV_CHIP_DIE_EXPECT EQU CYDEV_CHIP_MEMBER_USED
CYDEV_CHIP_DIE_ACTUAL EQU CYDEV_CHIP_DIE_EXPECT
CYDEV_CHIP_REV_LEOPARD_ES1 EQU 0
CYDEV_CHIP_REV_LEOPARD_ES2 EQU 1
CYDEV_CHIP_REV_LEOPARD_ES3 EQU 3
CYDEV_CHIP_REV_LEOPARD_PRODUCTION EQU 3
CYDEV_CHIP_REV_PSOC4A_ES0 EQU 17
CYDEV_CHIP_REV_PSOC4A_PRODUCTION EQU 17
CYDEV_CHIP_REV_PSOC5LP_ES0 EQU 0
CYDEV_CHIP_REV_PSOC5LP_PRODUCTION EQU 0
CYDEV_CHIP_REV_PSOC5TM_ES0 EQU 0
CYDEV_CHIP_REV_PSOC5TM_ES1 EQU 1
CYDEV_CHIP_REV_PSOC5TM_PRODUCTION EQU 1
CYDEV_CHIP_REV_TMA4_ES EQU 17
CYDEV_CHIP_REV_TMA4_ES2 EQU 33
CYDEV_CHIP_REV_TMA4_PRODUCTION EQU 17
CYDEV_CHIP_REVISION_3A_ES1 EQU 0
CYDEV_CHIP_REVISION_3A_ES2 EQU 1
CYDEV_CHIP_REVISION_3A_ES3 EQU 3
CYDEV_CHIP_REVISION_3A_PRODUCTION EQU 3
CYDEV_CHIP_REVISION_4A_ES0 EQU 17
CYDEV_CHIP_REVISION_4A_PRODUCTION EQU 17
CYDEV_CHIP_REVISION_4D_PRODUCTION EQU 0
CYDEV_CHIP_REVISION_4E_CCG2_NO_USBPD EQU 0
CYDEV_CHIP_REVISION_4E_PRODUCTION EQU 0
CYDEV_CHIP_REVISION_4F_PRODUCTION EQU 0
CYDEV_CHIP_REVISION_4F_PRODUCTION_256DMA EQU 0
CYDEV_CHIP_REVISION_4F_PRODUCTION_256K EQU 0
CYDEV_CHIP_REVISION_4G_ES EQU 17
CYDEV_CHIP_REVISION_4G_ES2 EQU 33
CYDEV_CHIP_REVISION_4G_PRODUCTION EQU 17
CYDEV_CHIP_REVISION_4H_PRODUCTION EQU 0
CYDEV_CHIP_REVISION_4I_PRODUCTION EQU 0
CYDEV_CHIP_REVISION_4J_PRODUCTION EQU 0
CYDEV_CHIP_REVISION_4K_PRODUCTION EQU 0
CYDEV_CHIP_REVISION_4L_PRODUCTION EQU 0
CYDEV_CHIP_REVISION_4M_PRODUCTION EQU 0
CYDEV_CHIP_REVISION_4N_PRODUCTION EQU 0
CYDEV_CHIP_REVISION_4O_PRODUCTION EQU 0
CYDEV_CHIP_REVISION_4P_PRODUCTION EQU 0
CYDEV_CHIP_REVISION_4Q_PRODUCTION EQU 0
CYDEV_CHIP_REVISION_4R_PRODUCTION EQU 0
CYDEV_CHIP_REVISION_4S_PRODUCTION EQU 0
CYDEV_CHIP_REVISION_4T_PRODUCTION EQU 0
CYDEV_CHIP_REVISION_4U_PRODUCTION EQU 0
CYDEV_CHIP_REVISION_4V_PRODUCTION EQU 0
CYDEV_CHIP_REVISION_5A_ES0 EQU 0
CYDEV_CHIP_REVISION_5A_ES1 EQU 1
CYDEV_CHIP_REVISION_5A_PRODUCTION EQU 1
CYDEV_CHIP_REVISION_5B_ES0 EQU 0
CYDEV_CHIP_REVISION_5B_PRODUCTION EQU 0
CYDEV_CHIP_REVISION_6A_ES EQU 17
CYDEV_CHIP_REVISION_6A_NO_UDB EQU 33
CYDEV_CHIP_REVISION_6A_PRODUCTION EQU 33
CYDEV_CHIP_REVISION_FM3_PRODUCTION EQU 0
CYDEV_CHIP_REVISION_FM4_PRODUCTION EQU 0
CYDEV_CHIP_REVISION_PDL_FM0P_TYPE1_PRODUCTION EQU 0
CYDEV_CHIP_REVISION_PDL_FM0P_TYPE2_PRODUCTION EQU 0
CYDEV_CHIP_REVISION_PDL_FM0P_TYPE3_PRODUCTION EQU 0
CYDEV_CHIP_REVISION_USED EQU CYDEV_CHIP_REVISION_4L_PRODUCTION
CYDEV_CHIP_REV_EXPECT EQU CYDEV_CHIP_REVISION_USED
CYDEV_CONFIG_READ_ACCELERATOR EQU 1
CYDEV_CONFIG_UNUSED_IO_AllowButWarn EQU 0
CYDEV_CONFIG_UNUSED_IO_AllowWithInfo EQU 1
CYDEV_CONFIG_UNUSED_IO_Disallowed EQU 2
CYDEV_CONFIG_UNUSED_IO EQU CYDEV_CONFIG_UNUSED_IO_Disallowed
CYDEV_CONFIGURATION_COMPRESSED EQU 1
CYDEV_CONFIGURATION_MODE_COMPRESSED EQU 0
CYDEV_CONFIGURATION_MODE EQU CYDEV_CONFIGURATION_MODE_COMPRESSED
CYDEV_CONFIGURATION_MODE_DMA EQU 2
CYDEV_CONFIGURATION_MODE_UNCOMPRESSED EQU 1
CYDEV_DEBUG_PROTECT_KILL EQU 4
CYDEV_DEBUG_PROTECT_OPEN EQU 1
CYDEV_DEBUG_PROTECT EQU CYDEV_DEBUG_PROTECT_OPEN
CYDEV_DEBUG_PROTECT_PROTECTED EQU 2
CYDEV_DEBUGGING_DPS_Disable EQU 3
CYDEV_DEBUGGING_DPS_SWD EQU 2
CYDEV_DEBUGGING_DPS EQU CYDEV_DEBUGGING_DPS_SWD
CYDEV_DEBUGGING_ENABLE EQU 1
CYDEV_DFT_SELECT_CLK0 EQU 8
CYDEV_DFT_SELECT_CLK1 EQU 9
CYDEV_DMA_CHANNELS_AVAILABLE EQU 32
CYDEV_HEAP_SIZE EQU 0x80
CYDEV_IMO_TRIMMED_BY_USB EQU 0
CYDEV_IMO_TRIMMED_BY_WCO EQU 0
CYDEV_INTR_NUMBER_DMA EQU 14
CYDEV_IS_EXPORTING_CODE EQU 0
CYDEV_IS_IMPORTING_CODE EQU 0
CYDEV_PROJ_TYPE EQU 0
CYDEV_PROJ_TYPE_BOOTLOADER EQU 1
CYDEV_PROJ_TYPE_LAUNCHER EQU 5
CYDEV_PROJ_TYPE_LOADABLE EQU 2
CYDEV_PROJ_TYPE_LOADABLEANDBOOTLOADER EQU 4
CYDEV_PROJ_TYPE_MULTIAPPBOOTLOADER EQU 3
CYDEV_PROJ_TYPE_STANDARD EQU 0
CYDEV_STACK_SIZE EQU 0x0800
CYDEV_USE_BUNDLED_CMSIS EQU 1
CYDEV_VARIABLE_VDDA EQU 1
CYDEV_VBUS_MV EQU 5000
CYDEV_VDDA_MV EQU 3300
CYDEV_VDDD_MV EQU 3300
CYDEV_VDDIO_MV EQU 3300
CYDEV_WDT_GENERATE_ISR EQU 1
CYIPBLOCK_m0s8can_VERSION EQU 1
CYIPBLOCK_m0s8cpussv2_VERSION EQU 1
CYIPBLOCK_m0s8csd_VERSION EQU 1
CYIPBLOCK_m0s8ioss_VERSION EQU 1
CYIPBLOCK_m0s8lcd_VERSION EQU 2
CYIPBLOCK_m0s8lpcomp_VERSION EQU 2
CYIPBLOCK_m0s8peri_VERSION EQU 1
CYIPBLOCK_m0s8scb_VERSION EQU 2
CYIPBLOCK_m0s8srssv2_VERSION EQU 2
CYIPBLOCK_m0s8tcpwm_VERSION EQU 2
CYIPBLOCK_m0s8udb_VERSION EQU 1
CYIPBLOCK_m0s8usbdss_VERSION EQU 2
CYIPBLOCK_m0s8wco_VERSION EQU 1
CYIPBLOCK_s8pass4al_VERSION EQU 1
DMA_CHANNELS_USED__MASK EQU 0
CYDEV_BOOTLOADER_ENABLE EQU 0

#endif /* INCLUDED_CYFITTERIAR_INC */
