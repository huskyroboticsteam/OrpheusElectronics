;
; File Name: cyfitterrv.inc
; 
; PSoC Creator  4.2
;
; Description:
; 
;
;-------------------------------------------------------------------------------
; Copyright (c) 2007-2018 Cypress Semiconductor.  All rights reserved.
; You may use this file only in accordance with the license, terms, conditions, 
; disclaimers, and limitations in the end user license agreement accompanying 
; the software package with which this file was provided.
;-------------------------------------------------------------------------------

    IF :LNOT::DEF:INCLUDED_CYFITTERRV_INC
INCLUDED_CYFITTERRV_INC EQU 1
    GET cydevicerv_trm.inc

; vin
vin__0__DR EQU CYREG_GPIO_PRT1_DR
vin__0__DR_CLR EQU CYREG_GPIO_PRT1_DR_CLR
vin__0__DR_INV EQU CYREG_GPIO_PRT1_DR_INV
vin__0__DR_SET EQU CYREG_GPIO_PRT1_DR_SET
vin__0__HSIOM EQU CYREG_HSIOM_PORT_SEL1
vin__0__HSIOM_MASK EQU 0x0000000F
vin__0__HSIOM_SHIFT EQU 0
vin__0__INTCFG EQU CYREG_GPIO_PRT1_INTR_CFG
vin__0__INTR EQU CYREG_GPIO_PRT1_INTR
vin__0__INTR_CFG EQU CYREG_GPIO_PRT1_INTR_CFG
vin__0__INTSTAT EQU CYREG_GPIO_PRT1_INTR
vin__0__MASK EQU 0x01
vin__0__PA__CFG0 EQU CYREG_UDB_PA1_CFG0
vin__0__PA__CFG1 EQU CYREG_UDB_PA1_CFG1
vin__0__PA__CFG10 EQU CYREG_UDB_PA1_CFG10
vin__0__PA__CFG11 EQU CYREG_UDB_PA1_CFG11
vin__0__PA__CFG12 EQU CYREG_UDB_PA1_CFG12
vin__0__PA__CFG13 EQU CYREG_UDB_PA1_CFG13
vin__0__PA__CFG14 EQU CYREG_UDB_PA1_CFG14
vin__0__PA__CFG2 EQU CYREG_UDB_PA1_CFG2
vin__0__PA__CFG3 EQU CYREG_UDB_PA1_CFG3
vin__0__PA__CFG4 EQU CYREG_UDB_PA1_CFG4
vin__0__PA__CFG5 EQU CYREG_UDB_PA1_CFG5
vin__0__PA__CFG6 EQU CYREG_UDB_PA1_CFG6
vin__0__PA__CFG7 EQU CYREG_UDB_PA1_CFG7
vin__0__PA__CFG8 EQU CYREG_UDB_PA1_CFG8
vin__0__PA__CFG9 EQU CYREG_UDB_PA1_CFG9
vin__0__PC EQU CYREG_GPIO_PRT1_PC
vin__0__PC2 EQU CYREG_GPIO_PRT1_PC2
vin__0__PORT EQU 1
vin__0__PS EQU CYREG_GPIO_PRT1_PS
vin__0__SHIFT EQU 0
vin__DR EQU CYREG_GPIO_PRT1_DR
vin__DR_CLR EQU CYREG_GPIO_PRT1_DR_CLR
vin__DR_INV EQU CYREG_GPIO_PRT1_DR_INV
vin__DR_SET EQU CYREG_GPIO_PRT1_DR_SET
vin__INTCFG EQU CYREG_GPIO_PRT1_INTR_CFG
vin__INTR EQU CYREG_GPIO_PRT1_INTR
vin__INTR_CFG EQU CYREG_GPIO_PRT1_INTR_CFG
vin__INTSTAT EQU CYREG_GPIO_PRT1_INTR
vin__MASK EQU 0x01
vin__PA__CFG0 EQU CYREG_UDB_PA1_CFG0
vin__PA__CFG1 EQU CYREG_UDB_PA1_CFG1
vin__PA__CFG10 EQU CYREG_UDB_PA1_CFG10
vin__PA__CFG11 EQU CYREG_UDB_PA1_CFG11
vin__PA__CFG12 EQU CYREG_UDB_PA1_CFG12
vin__PA__CFG13 EQU CYREG_UDB_PA1_CFG13
vin__PA__CFG14 EQU CYREG_UDB_PA1_CFG14
vin__PA__CFG2 EQU CYREG_UDB_PA1_CFG2
vin__PA__CFG3 EQU CYREG_UDB_PA1_CFG3
vin__PA__CFG4 EQU CYREG_UDB_PA1_CFG4
vin__PA__CFG5 EQU CYREG_UDB_PA1_CFG5
vin__PA__CFG6 EQU CYREG_UDB_PA1_CFG6
vin__PA__CFG7 EQU CYREG_UDB_PA1_CFG7
vin__PA__CFG8 EQU CYREG_UDB_PA1_CFG8
vin__PA__CFG9 EQU CYREG_UDB_PA1_CFG9
vin__PC EQU CYREG_GPIO_PRT1_PC
vin__PC2 EQU CYREG_GPIO_PRT1_PC2
vin__PORT EQU 1
vin__PS EQU CYREG_GPIO_PRT1_PS
vin__SHIFT EQU 0

; UART
UART_rx__0__DR EQU CYREG_GPIO_PRT4_DR
UART_rx__0__DR_CLR EQU CYREG_GPIO_PRT4_DR_CLR
UART_rx__0__DR_INV EQU CYREG_GPIO_PRT4_DR_INV
UART_rx__0__DR_SET EQU CYREG_GPIO_PRT4_DR_SET
UART_rx__0__HSIOM EQU CYREG_HSIOM_PORT_SEL4
UART_rx__0__HSIOM_GPIO EQU 0
UART_rx__0__HSIOM_I2C EQU 14
UART_rx__0__HSIOM_I2C_SCL EQU 14
UART_rx__0__HSIOM_MASK EQU 0x0000000F
UART_rx__0__HSIOM_SHIFT EQU 0
UART_rx__0__HSIOM_SPI EQU 15
UART_rx__0__HSIOM_SPI_MOSI EQU 15
UART_rx__0__HSIOM_UART EQU 9
UART_rx__0__HSIOM_UART_RX EQU 9
UART_rx__0__INTCFG EQU CYREG_GPIO_PRT4_INTR_CFG
UART_rx__0__INTR EQU CYREG_GPIO_PRT4_INTR
UART_rx__0__INTR_CFG EQU CYREG_GPIO_PRT4_INTR_CFG
UART_rx__0__INTSTAT EQU CYREG_GPIO_PRT4_INTR
UART_rx__0__MASK EQU 0x01
UART_rx__0__PA__CFG0 EQU CYREG_UDB_PA5_CFG0
UART_rx__0__PA__CFG1 EQU CYREG_UDB_PA5_CFG1
UART_rx__0__PA__CFG10 EQU CYREG_UDB_PA5_CFG10
UART_rx__0__PA__CFG11 EQU CYREG_UDB_PA5_CFG11
UART_rx__0__PA__CFG12 EQU CYREG_UDB_PA5_CFG12
UART_rx__0__PA__CFG13 EQU CYREG_UDB_PA5_CFG13
UART_rx__0__PA__CFG14 EQU CYREG_UDB_PA5_CFG14
UART_rx__0__PA__CFG2 EQU CYREG_UDB_PA5_CFG2
UART_rx__0__PA__CFG3 EQU CYREG_UDB_PA5_CFG3
UART_rx__0__PA__CFG4 EQU CYREG_UDB_PA5_CFG4
UART_rx__0__PA__CFG5 EQU CYREG_UDB_PA5_CFG5
UART_rx__0__PA__CFG6 EQU CYREG_UDB_PA5_CFG6
UART_rx__0__PA__CFG7 EQU CYREG_UDB_PA5_CFG7
UART_rx__0__PA__CFG8 EQU CYREG_UDB_PA5_CFG8
UART_rx__0__PA__CFG9 EQU CYREG_UDB_PA5_CFG9
UART_rx__0__PC EQU CYREG_GPIO_PRT4_PC
UART_rx__0__PC2 EQU CYREG_GPIO_PRT4_PC2
UART_rx__0__PORT EQU 4
UART_rx__0__PS EQU CYREG_GPIO_PRT4_PS
UART_rx__0__SHIFT EQU 0
UART_rx__DR EQU CYREG_GPIO_PRT4_DR
UART_rx__DR_CLR EQU CYREG_GPIO_PRT4_DR_CLR
UART_rx__DR_INV EQU CYREG_GPIO_PRT4_DR_INV
UART_rx__DR_SET EQU CYREG_GPIO_PRT4_DR_SET
UART_rx__INTCFG EQU CYREG_GPIO_PRT4_INTR_CFG
UART_rx__INTR EQU CYREG_GPIO_PRT4_INTR
UART_rx__INTR_CFG EQU CYREG_GPIO_PRT4_INTR_CFG
UART_rx__INTSTAT EQU CYREG_GPIO_PRT4_INTR
UART_rx__MASK EQU 0x01
UART_rx__PA__CFG0 EQU CYREG_UDB_PA5_CFG0
UART_rx__PA__CFG1 EQU CYREG_UDB_PA5_CFG1
UART_rx__PA__CFG10 EQU CYREG_UDB_PA5_CFG10
UART_rx__PA__CFG11 EQU CYREG_UDB_PA5_CFG11
UART_rx__PA__CFG12 EQU CYREG_UDB_PA5_CFG12
UART_rx__PA__CFG13 EQU CYREG_UDB_PA5_CFG13
UART_rx__PA__CFG14 EQU CYREG_UDB_PA5_CFG14
UART_rx__PA__CFG2 EQU CYREG_UDB_PA5_CFG2
UART_rx__PA__CFG3 EQU CYREG_UDB_PA5_CFG3
UART_rx__PA__CFG4 EQU CYREG_UDB_PA5_CFG4
UART_rx__PA__CFG5 EQU CYREG_UDB_PA5_CFG5
UART_rx__PA__CFG6 EQU CYREG_UDB_PA5_CFG6
UART_rx__PA__CFG7 EQU CYREG_UDB_PA5_CFG7
UART_rx__PA__CFG8 EQU CYREG_UDB_PA5_CFG8
UART_rx__PA__CFG9 EQU CYREG_UDB_PA5_CFG9
UART_rx__PC EQU CYREG_GPIO_PRT4_PC
UART_rx__PC2 EQU CYREG_GPIO_PRT4_PC2
UART_rx__PORT EQU 4
UART_rx__PS EQU CYREG_GPIO_PRT4_PS
UART_rx__SHIFT EQU 0
UART_SCB__CTRL EQU CYREG_SCB0_CTRL
UART_SCB__EZ_DATA0 EQU CYREG_SCB0_EZ_DATA0
UART_SCB__EZ_DATA1 EQU CYREG_SCB0_EZ_DATA1
UART_SCB__EZ_DATA10 EQU CYREG_SCB0_EZ_DATA10
UART_SCB__EZ_DATA11 EQU CYREG_SCB0_EZ_DATA11
UART_SCB__EZ_DATA12 EQU CYREG_SCB0_EZ_DATA12
UART_SCB__EZ_DATA13 EQU CYREG_SCB0_EZ_DATA13
UART_SCB__EZ_DATA14 EQU CYREG_SCB0_EZ_DATA14
UART_SCB__EZ_DATA15 EQU CYREG_SCB0_EZ_DATA15
UART_SCB__EZ_DATA16 EQU CYREG_SCB0_EZ_DATA16
UART_SCB__EZ_DATA17 EQU CYREG_SCB0_EZ_DATA17
UART_SCB__EZ_DATA18 EQU CYREG_SCB0_EZ_DATA18
UART_SCB__EZ_DATA19 EQU CYREG_SCB0_EZ_DATA19
UART_SCB__EZ_DATA2 EQU CYREG_SCB0_EZ_DATA2
UART_SCB__EZ_DATA20 EQU CYREG_SCB0_EZ_DATA20
UART_SCB__EZ_DATA21 EQU CYREG_SCB0_EZ_DATA21
UART_SCB__EZ_DATA22 EQU CYREG_SCB0_EZ_DATA22
UART_SCB__EZ_DATA23 EQU CYREG_SCB0_EZ_DATA23
UART_SCB__EZ_DATA24 EQU CYREG_SCB0_EZ_DATA24
UART_SCB__EZ_DATA25 EQU CYREG_SCB0_EZ_DATA25
UART_SCB__EZ_DATA26 EQU CYREG_SCB0_EZ_DATA26
UART_SCB__EZ_DATA27 EQU CYREG_SCB0_EZ_DATA27
UART_SCB__EZ_DATA28 EQU CYREG_SCB0_EZ_DATA28
UART_SCB__EZ_DATA29 EQU CYREG_SCB0_EZ_DATA29
UART_SCB__EZ_DATA3 EQU CYREG_SCB0_EZ_DATA3
UART_SCB__EZ_DATA30 EQU CYREG_SCB0_EZ_DATA30
UART_SCB__EZ_DATA31 EQU CYREG_SCB0_EZ_DATA31
UART_SCB__EZ_DATA4 EQU CYREG_SCB0_EZ_DATA4
UART_SCB__EZ_DATA5 EQU CYREG_SCB0_EZ_DATA5
UART_SCB__EZ_DATA6 EQU CYREG_SCB0_EZ_DATA6
UART_SCB__EZ_DATA7 EQU CYREG_SCB0_EZ_DATA7
UART_SCB__EZ_DATA8 EQU CYREG_SCB0_EZ_DATA8
UART_SCB__EZ_DATA9 EQU CYREG_SCB0_EZ_DATA9
UART_SCB__I2C_CFG EQU CYREG_SCB0_I2C_CFG
UART_SCB__I2C_CTRL EQU CYREG_SCB0_I2C_CTRL
UART_SCB__I2C_M_CMD EQU CYREG_SCB0_I2C_M_CMD
UART_SCB__I2C_S_CMD EQU CYREG_SCB0_I2C_S_CMD
UART_SCB__I2C_STATUS EQU CYREG_SCB0_I2C_STATUS
UART_SCB__INTR_CAUSE EQU CYREG_SCB0_INTR_CAUSE
UART_SCB__INTR_I2C_EC EQU CYREG_SCB0_INTR_I2C_EC
UART_SCB__INTR_I2C_EC_MASK EQU CYREG_SCB0_INTR_I2C_EC_MASK
UART_SCB__INTR_I2C_EC_MASKED EQU CYREG_SCB0_INTR_I2C_EC_MASKED
UART_SCB__INTR_M EQU CYREG_SCB0_INTR_M
UART_SCB__INTR_M_MASK EQU CYREG_SCB0_INTR_M_MASK
UART_SCB__INTR_M_MASKED EQU CYREG_SCB0_INTR_M_MASKED
UART_SCB__INTR_M_SET EQU CYREG_SCB0_INTR_M_SET
UART_SCB__INTR_RX EQU CYREG_SCB0_INTR_RX
UART_SCB__INTR_RX_MASK EQU CYREG_SCB0_INTR_RX_MASK
UART_SCB__INTR_RX_MASKED EQU CYREG_SCB0_INTR_RX_MASKED
UART_SCB__INTR_RX_SET EQU CYREG_SCB0_INTR_RX_SET
UART_SCB__INTR_S EQU CYREG_SCB0_INTR_S
UART_SCB__INTR_S_MASK EQU CYREG_SCB0_INTR_S_MASK
UART_SCB__INTR_S_MASKED EQU CYREG_SCB0_INTR_S_MASKED
UART_SCB__INTR_S_SET EQU CYREG_SCB0_INTR_S_SET
UART_SCB__INTR_SPI_EC EQU CYREG_SCB0_INTR_SPI_EC
UART_SCB__INTR_SPI_EC_MASK EQU CYREG_SCB0_INTR_SPI_EC_MASK
UART_SCB__INTR_SPI_EC_MASKED EQU CYREG_SCB0_INTR_SPI_EC_MASKED
UART_SCB__INTR_TX EQU CYREG_SCB0_INTR_TX
UART_SCB__INTR_TX_MASK EQU CYREG_SCB0_INTR_TX_MASK
UART_SCB__INTR_TX_MASKED EQU CYREG_SCB0_INTR_TX_MASKED
UART_SCB__INTR_TX_SET EQU CYREG_SCB0_INTR_TX_SET
UART_SCB__RX_CTRL EQU CYREG_SCB0_RX_CTRL
UART_SCB__RX_FIFO_CTRL EQU CYREG_SCB0_RX_FIFO_CTRL
UART_SCB__RX_FIFO_RD EQU CYREG_SCB0_RX_FIFO_RD
UART_SCB__RX_FIFO_RD_SILENT EQU CYREG_SCB0_RX_FIFO_RD_SILENT
UART_SCB__RX_FIFO_STATUS EQU CYREG_SCB0_RX_FIFO_STATUS
UART_SCB__RX_MATCH EQU CYREG_SCB0_RX_MATCH
UART_SCB__SPI_CTRL EQU CYREG_SCB0_SPI_CTRL
UART_SCB__SPI_STATUS EQU CYREG_SCB0_SPI_STATUS
UART_SCB__SS0_POSISTION EQU 0
UART_SCB__SS1_POSISTION EQU 1
UART_SCB__SS2_POSISTION EQU 2
UART_SCB__SS3_POSISTION EQU 3
UART_SCB__STATUS EQU CYREG_SCB0_STATUS
UART_SCB__TX_CTRL EQU CYREG_SCB0_TX_CTRL
UART_SCB__TX_FIFO_CTRL EQU CYREG_SCB0_TX_FIFO_CTRL
UART_SCB__TX_FIFO_STATUS EQU CYREG_SCB0_TX_FIFO_STATUS
UART_SCB__TX_FIFO_WR EQU CYREG_SCB0_TX_FIFO_WR
UART_SCB__UART_CTRL EQU CYREG_SCB0_UART_CTRL
UART_SCB__UART_FLOW_CTRL EQU CYREG_SCB0_UART_FLOW_CTRL
UART_SCB__UART_RX_CTRL EQU CYREG_SCB0_UART_RX_CTRL
UART_SCB__UART_RX_STATUS EQU CYREG_SCB0_UART_RX_STATUS
UART_SCB__UART_TX_CTRL EQU CYREG_SCB0_UART_TX_CTRL
UART_SCBCLK__CTRL_REGISTER EQU CYREG_PERI_PCLK_CTL2
UART_SCBCLK__DIV_ID EQU 0x00000040
UART_SCBCLK__DIV_REGISTER EQU CYREG_PERI_DIV_16_CTL0
UART_SCBCLK__PA_DIV_ID EQU 0x000000FF
UART_tx__0__DR EQU CYREG_GPIO_PRT1_DR
UART_tx__0__DR_CLR EQU CYREG_GPIO_PRT1_DR_CLR
UART_tx__0__DR_INV EQU CYREG_GPIO_PRT1_DR_INV
UART_tx__0__DR_SET EQU CYREG_GPIO_PRT1_DR_SET
UART_tx__0__HSIOM EQU CYREG_HSIOM_PORT_SEL1
UART_tx__0__HSIOM_GPIO EQU 0
UART_tx__0__HSIOM_I2C EQU 14
UART_tx__0__HSIOM_I2C_SDA EQU 14
UART_tx__0__HSIOM_MASK EQU 0x000000F0
UART_tx__0__HSIOM_SHIFT EQU 4
UART_tx__0__HSIOM_SPI EQU 15
UART_tx__0__HSIOM_SPI_MISO EQU 15
UART_tx__0__HSIOM_UART EQU 9
UART_tx__0__HSIOM_UART_TX EQU 9
UART_tx__0__INTCFG EQU CYREG_GPIO_PRT1_INTR_CFG
UART_tx__0__INTR EQU CYREG_GPIO_PRT1_INTR
UART_tx__0__INTR_CFG EQU CYREG_GPIO_PRT1_INTR_CFG
UART_tx__0__INTSTAT EQU CYREG_GPIO_PRT1_INTR
UART_tx__0__MASK EQU 0x02
UART_tx__0__OUT_SEL EQU CYREG_UDB_PA1_CFG10
UART_tx__0__OUT_SEL_SHIFT EQU 2
UART_tx__0__OUT_SEL_VAL EQU -1
UART_tx__0__PA__CFG0 EQU CYREG_UDB_PA1_CFG0
UART_tx__0__PA__CFG1 EQU CYREG_UDB_PA1_CFG1
UART_tx__0__PA__CFG10 EQU CYREG_UDB_PA1_CFG10
UART_tx__0__PA__CFG11 EQU CYREG_UDB_PA1_CFG11
UART_tx__0__PA__CFG12 EQU CYREG_UDB_PA1_CFG12
UART_tx__0__PA__CFG13 EQU CYREG_UDB_PA1_CFG13
UART_tx__0__PA__CFG14 EQU CYREG_UDB_PA1_CFG14
UART_tx__0__PA__CFG2 EQU CYREG_UDB_PA1_CFG2
UART_tx__0__PA__CFG3 EQU CYREG_UDB_PA1_CFG3
UART_tx__0__PA__CFG4 EQU CYREG_UDB_PA1_CFG4
UART_tx__0__PA__CFG5 EQU CYREG_UDB_PA1_CFG5
UART_tx__0__PA__CFG6 EQU CYREG_UDB_PA1_CFG6
UART_tx__0__PA__CFG7 EQU CYREG_UDB_PA1_CFG7
UART_tx__0__PA__CFG8 EQU CYREG_UDB_PA1_CFG8
UART_tx__0__PA__CFG9 EQU CYREG_UDB_PA1_CFG9
UART_tx__0__PC EQU CYREG_GPIO_PRT1_PC
UART_tx__0__PC2 EQU CYREG_GPIO_PRT1_PC2
UART_tx__0__PORT EQU 1
UART_tx__0__PS EQU CYREG_GPIO_PRT1_PS
UART_tx__0__SHIFT EQU 1
UART_tx__DR EQU CYREG_GPIO_PRT1_DR
UART_tx__DR_CLR EQU CYREG_GPIO_PRT1_DR_CLR
UART_tx__DR_INV EQU CYREG_GPIO_PRT1_DR_INV
UART_tx__DR_SET EQU CYREG_GPIO_PRT1_DR_SET
UART_tx__INTCFG EQU CYREG_GPIO_PRT1_INTR_CFG
UART_tx__INTR EQU CYREG_GPIO_PRT1_INTR
UART_tx__INTR_CFG EQU CYREG_GPIO_PRT1_INTR_CFG
UART_tx__INTSTAT EQU CYREG_GPIO_PRT1_INTR
UART_tx__MASK EQU 0x02
UART_tx__PA__CFG0 EQU CYREG_UDB_PA1_CFG0
UART_tx__PA__CFG1 EQU CYREG_UDB_PA1_CFG1
UART_tx__PA__CFG10 EQU CYREG_UDB_PA1_CFG10
UART_tx__PA__CFG11 EQU CYREG_UDB_PA1_CFG11
UART_tx__PA__CFG12 EQU CYREG_UDB_PA1_CFG12
UART_tx__PA__CFG13 EQU CYREG_UDB_PA1_CFG13
UART_tx__PA__CFG14 EQU CYREG_UDB_PA1_CFG14
UART_tx__PA__CFG2 EQU CYREG_UDB_PA1_CFG2
UART_tx__PA__CFG3 EQU CYREG_UDB_PA1_CFG3
UART_tx__PA__CFG4 EQU CYREG_UDB_PA1_CFG4
UART_tx__PA__CFG5 EQU CYREG_UDB_PA1_CFG5
UART_tx__PA__CFG6 EQU CYREG_UDB_PA1_CFG6
UART_tx__PA__CFG7 EQU CYREG_UDB_PA1_CFG7
UART_tx__PA__CFG8 EQU CYREG_UDB_PA1_CFG8
UART_tx__PA__CFG9 EQU CYREG_UDB_PA1_CFG9
UART_tx__PC EQU CYREG_GPIO_PRT1_PC
UART_tx__PC2 EQU CYREG_GPIO_PRT1_PC2
UART_tx__PORT EQU 1
UART_tx__PS EQU CYREG_GPIO_PRT1_PS
UART_tx__SHIFT EQU 1

; vout
vout__0__DR EQU CYREG_GPIO_PRT1_DR
vout__0__DR_CLR EQU CYREG_GPIO_PRT1_DR_CLR
vout__0__DR_INV EQU CYREG_GPIO_PRT1_DR_INV
vout__0__DR_SET EQU CYREG_GPIO_PRT1_DR_SET
vout__0__HSIOM EQU CYREG_HSIOM_PORT_SEL1
vout__0__HSIOM_MASK EQU 0x00000F00
vout__0__HSIOM_SHIFT EQU 8
vout__0__INTCFG EQU CYREG_GPIO_PRT1_INTR_CFG
vout__0__INTR EQU CYREG_GPIO_PRT1_INTR
vout__0__INTR_CFG EQU CYREG_GPIO_PRT1_INTR_CFG
vout__0__INTSTAT EQU CYREG_GPIO_PRT1_INTR
vout__0__MASK EQU 0x04
vout__0__PA__CFG0 EQU CYREG_UDB_PA1_CFG0
vout__0__PA__CFG1 EQU CYREG_UDB_PA1_CFG1
vout__0__PA__CFG10 EQU CYREG_UDB_PA1_CFG10
vout__0__PA__CFG11 EQU CYREG_UDB_PA1_CFG11
vout__0__PA__CFG12 EQU CYREG_UDB_PA1_CFG12
vout__0__PA__CFG13 EQU CYREG_UDB_PA1_CFG13
vout__0__PA__CFG14 EQU CYREG_UDB_PA1_CFG14
vout__0__PA__CFG2 EQU CYREG_UDB_PA1_CFG2
vout__0__PA__CFG3 EQU CYREG_UDB_PA1_CFG3
vout__0__PA__CFG4 EQU CYREG_UDB_PA1_CFG4
vout__0__PA__CFG5 EQU CYREG_UDB_PA1_CFG5
vout__0__PA__CFG6 EQU CYREG_UDB_PA1_CFG6
vout__0__PA__CFG7 EQU CYREG_UDB_PA1_CFG7
vout__0__PA__CFG8 EQU CYREG_UDB_PA1_CFG8
vout__0__PA__CFG9 EQU CYREG_UDB_PA1_CFG9
vout__0__PC EQU CYREG_GPIO_PRT1_PC
vout__0__PC2 EQU CYREG_GPIO_PRT1_PC2
vout__0__PORT EQU 1
vout__0__PS EQU CYREG_GPIO_PRT1_PS
vout__0__SHIFT EQU 2
vout__DR EQU CYREG_GPIO_PRT1_DR
vout__DR_CLR EQU CYREG_GPIO_PRT1_DR_CLR
vout__DR_INV EQU CYREG_GPIO_PRT1_DR_INV
vout__DR_SET EQU CYREG_GPIO_PRT1_DR_SET
vout__INTCFG EQU CYREG_GPIO_PRT1_INTR_CFG
vout__INTR EQU CYREG_GPIO_PRT1_INTR
vout__INTR_CFG EQU CYREG_GPIO_PRT1_INTR_CFG
vout__INTSTAT EQU CYREG_GPIO_PRT1_INTR
vout__MASK EQU 0x04
vout__PA__CFG0 EQU CYREG_UDB_PA1_CFG0
vout__PA__CFG1 EQU CYREG_UDB_PA1_CFG1
vout__PA__CFG10 EQU CYREG_UDB_PA1_CFG10
vout__PA__CFG11 EQU CYREG_UDB_PA1_CFG11
vout__PA__CFG12 EQU CYREG_UDB_PA1_CFG12
vout__PA__CFG13 EQU CYREG_UDB_PA1_CFG13
vout__PA__CFG14 EQU CYREG_UDB_PA1_CFG14
vout__PA__CFG2 EQU CYREG_UDB_PA1_CFG2
vout__PA__CFG3 EQU CYREG_UDB_PA1_CFG3
vout__PA__CFG4 EQU CYREG_UDB_PA1_CFG4
vout__PA__CFG5 EQU CYREG_UDB_PA1_CFG5
vout__PA__CFG6 EQU CYREG_UDB_PA1_CFG6
vout__PA__CFG7 EQU CYREG_UDB_PA1_CFG7
vout__PA__CFG8 EQU CYREG_UDB_PA1_CFG8
vout__PA__CFG9 EQU CYREG_UDB_PA1_CFG9
vout__PC EQU CYREG_GPIO_PRT1_PC
vout__PC2 EQU CYREG_GPIO_PRT1_PC2
vout__PORT EQU 1
vout__PS EQU CYREG_GPIO_PRT1_PS
vout__SHIFT EQU 2

; Opamp
Opamp_cy_psoc4_abuf__COMP_STAT EQU CYREG_CTBM0_COMP_STAT
Opamp_cy_psoc4_abuf__COMP_STAT_SHIFT EQU 0
Opamp_cy_psoc4_abuf__CTBM_CTB_CTRL EQU CYREG_CTBM0_CTB_CTRL
Opamp_cy_psoc4_abuf__INTR EQU CYREG_CTBM0_INTR
Opamp_cy_psoc4_abuf__INTR_MASK EQU CYREG_CTBM0_INTR_MASK
Opamp_cy_psoc4_abuf__INTR_MASK_SHIFT EQU 0
Opamp_cy_psoc4_abuf__INTR_MASKED EQU CYREG_CTBM0_INTR_MASKED
Opamp_cy_psoc4_abuf__INTR_MASKED_SHIFT EQU 0
Opamp_cy_psoc4_abuf__INTR_SET EQU CYREG_CTBM0_INTR_SET
Opamp_cy_psoc4_abuf__INTR_SET_SHIFT EQU 0
Opamp_cy_psoc4_abuf__INTR_SHIFT EQU 0
Opamp_cy_psoc4_abuf__OA_COMP_TRIM EQU CYREG_CTBM0_OA0_COMP_TRIM
Opamp_cy_psoc4_abuf__OA_NUMBER EQU 0
Opamp_cy_psoc4_abuf__OA_OFFSET_TRIM EQU CYREG_CTBM0_OA0_OFFSET_TRIM
Opamp_cy_psoc4_abuf__OA_RES_CTRL EQU CYREG_CTBM0_OA_RES0_CTRL
Opamp_cy_psoc4_abuf__OA_SLOPE_OFFSET_TRIM EQU CYREG_CTBM0_OA0_SLOPE_OFFSET_TRIM
Opamp_cy_psoc4_abuf__OA_SW EQU CYREG_CTBM0_OA0_SW
Opamp_cy_psoc4_abuf__OA_SW_CLEAR EQU CYREG_CTBM0_OA0_SW_CLEAR

; Pin_1
Pin_1__0__DR EQU CYREG_GPIO_PRT12_DR
Pin_1__0__DR_CLR EQU CYREG_GPIO_PRT12_DR_CLR
Pin_1__0__DR_INV EQU CYREG_GPIO_PRT12_DR_INV
Pin_1__0__DR_SET EQU CYREG_GPIO_PRT12_DR_SET
Pin_1__0__HSIOM EQU CYREG_HSIOM_PORT_SEL12
Pin_1__0__HSIOM_MASK EQU 0x0000000F
Pin_1__0__HSIOM_SHIFT EQU 0
Pin_1__0__INTCFG EQU CYREG_GPIO_PRT12_INTR_CFG
Pin_1__0__INTR EQU CYREG_GPIO_PRT12_INTR
Pin_1__0__INTR_CFG EQU CYREG_GPIO_PRT12_INTR_CFG
Pin_1__0__INTSTAT EQU CYREG_GPIO_PRT12_INTR
Pin_1__0__MASK EQU 0x01
Pin_1__0__PC EQU CYREG_GPIO_PRT12_PC
Pin_1__0__PC2 EQU CYREG_GPIO_PRT12_PC2
Pin_1__0__PORT EQU 12
Pin_1__0__PS EQU CYREG_GPIO_PRT12_PS
Pin_1__0__SHIFT EQU 0
Pin_1__0__SIO EQU CYREG_GPIO_PRT12_SIO
Pin_1__0__SIO_DFT EQU CYREG_GPIO_PRT12_SIO_DFT
Pin_1__DR EQU CYREG_GPIO_PRT12_DR
Pin_1__DR_CLR EQU CYREG_GPIO_PRT12_DR_CLR
Pin_1__DR_INV EQU CYREG_GPIO_PRT12_DR_INV
Pin_1__DR_SET EQU CYREG_GPIO_PRT12_DR_SET
Pin_1__INTCFG EQU CYREG_GPIO_PRT12_INTR_CFG
Pin_1__INTR EQU CYREG_GPIO_PRT12_INTR
Pin_1__INTR_CFG EQU CYREG_GPIO_PRT12_INTR_CFG
Pin_1__INTSTAT EQU CYREG_GPIO_PRT12_INTR
Pin_1__MASK EQU 0x01
Pin_1__PC EQU CYREG_GPIO_PRT12_PC
Pin_1__PC2 EQU CYREG_GPIO_PRT12_PC2
Pin_1__PORT EQU 12
Pin_1__PS EQU CYREG_GPIO_PRT12_PS
Pin_1__SHIFT EQU 0
Pin_1__SIO EQU CYREG_GPIO_PRT12_SIO
Pin_1__SIO_DFT EQU CYREG_GPIO_PRT12_SIO_DFT

; Pin_2
Pin_2__0__DR EQU CYREG_GPIO_PRT2_DR
Pin_2__0__DR_CLR EQU CYREG_GPIO_PRT2_DR_CLR
Pin_2__0__DR_INV EQU CYREG_GPIO_PRT2_DR_INV
Pin_2__0__DR_SET EQU CYREG_GPIO_PRT2_DR_SET
Pin_2__0__HSIOM EQU CYREG_HSIOM_PORT_SEL2
Pin_2__0__HSIOM_MASK EQU 0x0000000F
Pin_2__0__HSIOM_SHIFT EQU 0
Pin_2__0__INTCFG EQU CYREG_GPIO_PRT2_INTR_CFG
Pin_2__0__INTR EQU CYREG_GPIO_PRT2_INTR
Pin_2__0__INTR_CFG EQU CYREG_GPIO_PRT2_INTR_CFG
Pin_2__0__INTSTAT EQU CYREG_GPIO_PRT2_INTR
Pin_2__0__MASK EQU 0x01
Pin_2__0__PA__CFG0 EQU CYREG_UDB_PA2_CFG0
Pin_2__0__PA__CFG1 EQU CYREG_UDB_PA2_CFG1
Pin_2__0__PA__CFG10 EQU CYREG_UDB_PA2_CFG10
Pin_2__0__PA__CFG11 EQU CYREG_UDB_PA2_CFG11
Pin_2__0__PA__CFG12 EQU CYREG_UDB_PA2_CFG12
Pin_2__0__PA__CFG13 EQU CYREG_UDB_PA2_CFG13
Pin_2__0__PA__CFG14 EQU CYREG_UDB_PA2_CFG14
Pin_2__0__PA__CFG2 EQU CYREG_UDB_PA2_CFG2
Pin_2__0__PA__CFG3 EQU CYREG_UDB_PA2_CFG3
Pin_2__0__PA__CFG4 EQU CYREG_UDB_PA2_CFG4
Pin_2__0__PA__CFG5 EQU CYREG_UDB_PA2_CFG5
Pin_2__0__PA__CFG6 EQU CYREG_UDB_PA2_CFG6
Pin_2__0__PA__CFG7 EQU CYREG_UDB_PA2_CFG7
Pin_2__0__PA__CFG8 EQU CYREG_UDB_PA2_CFG8
Pin_2__0__PA__CFG9 EQU CYREG_UDB_PA2_CFG9
Pin_2__0__PC EQU CYREG_GPIO_PRT2_PC
Pin_2__0__PC2 EQU CYREG_GPIO_PRT2_PC2
Pin_2__0__PORT EQU 2
Pin_2__0__PS EQU CYREG_GPIO_PRT2_PS
Pin_2__0__SHIFT EQU 0
Pin_2__DR EQU CYREG_GPIO_PRT2_DR
Pin_2__DR_CLR EQU CYREG_GPIO_PRT2_DR_CLR
Pin_2__DR_INV EQU CYREG_GPIO_PRT2_DR_INV
Pin_2__DR_SET EQU CYREG_GPIO_PRT2_DR_SET
Pin_2__INTCFG EQU CYREG_GPIO_PRT2_INTR_CFG
Pin_2__INTR EQU CYREG_GPIO_PRT2_INTR
Pin_2__INTR_CFG EQU CYREG_GPIO_PRT2_INTR_CFG
Pin_2__INTSTAT EQU CYREG_GPIO_PRT2_INTR
Pin_2__MASK EQU 0x01
Pin_2__PA__CFG0 EQU CYREG_UDB_PA2_CFG0
Pin_2__PA__CFG1 EQU CYREG_UDB_PA2_CFG1
Pin_2__PA__CFG10 EQU CYREG_UDB_PA2_CFG10
Pin_2__PA__CFG11 EQU CYREG_UDB_PA2_CFG11
Pin_2__PA__CFG12 EQU CYREG_UDB_PA2_CFG12
Pin_2__PA__CFG13 EQU CYREG_UDB_PA2_CFG13
Pin_2__PA__CFG14 EQU CYREG_UDB_PA2_CFG14
Pin_2__PA__CFG2 EQU CYREG_UDB_PA2_CFG2
Pin_2__PA__CFG3 EQU CYREG_UDB_PA2_CFG3
Pin_2__PA__CFG4 EQU CYREG_UDB_PA2_CFG4
Pin_2__PA__CFG5 EQU CYREG_UDB_PA2_CFG5
Pin_2__PA__CFG6 EQU CYREG_UDB_PA2_CFG6
Pin_2__PA__CFG7 EQU CYREG_UDB_PA2_CFG7
Pin_2__PA__CFG8 EQU CYREG_UDB_PA2_CFG8
Pin_2__PA__CFG9 EQU CYREG_UDB_PA2_CFG9
Pin_2__PC EQU CYREG_GPIO_PRT2_PC
Pin_2__PC2 EQU CYREG_GPIO_PRT2_PC2
Pin_2__PORT EQU 2
Pin_2__PS EQU CYREG_GPIO_PRT2_PS
Pin_2__SHIFT EQU 0

; ADC_SAR_Seq_1
ADC_SAR_Seq_1_cy_psoc4_sar__CLOCK_DIV_ID EQU 0x00000041
ADC_SAR_Seq_1_cy_psoc4_sar__SAR_ANA_TRIM EQU CYREG_SAR_ANA_TRIM
ADC_SAR_Seq_1_cy_psoc4_sar__SAR_AVG_STAT EQU CYREG_SAR_AVG_STAT
ADC_SAR_Seq_1_cy_psoc4_sar__SAR_CHAN_CONFIG00 EQU CYREG_SAR_CHAN_CONFIG0
ADC_SAR_Seq_1_cy_psoc4_sar__SAR_CHAN_CONFIG01 EQU CYREG_SAR_CHAN_CONFIG1
ADC_SAR_Seq_1_cy_psoc4_sar__SAR_CHAN_CONFIG02 EQU CYREG_SAR_CHAN_CONFIG2
ADC_SAR_Seq_1_cy_psoc4_sar__SAR_CHAN_CONFIG03 EQU CYREG_SAR_CHAN_CONFIG3
ADC_SAR_Seq_1_cy_psoc4_sar__SAR_CHAN_CONFIG04 EQU CYREG_SAR_CHAN_CONFIG4
ADC_SAR_Seq_1_cy_psoc4_sar__SAR_CHAN_CONFIG05 EQU CYREG_SAR_CHAN_CONFIG5
ADC_SAR_Seq_1_cy_psoc4_sar__SAR_CHAN_CONFIG06 EQU CYREG_SAR_CHAN_CONFIG6
ADC_SAR_Seq_1_cy_psoc4_sar__SAR_CHAN_CONFIG07 EQU CYREG_SAR_CHAN_CONFIG7
ADC_SAR_Seq_1_cy_psoc4_sar__SAR_CHAN_CONFIG08 EQU CYREG_SAR_CHAN_CONFIG8
ADC_SAR_Seq_1_cy_psoc4_sar__SAR_CHAN_CONFIG09 EQU CYREG_SAR_CHAN_CONFIG9
ADC_SAR_Seq_1_cy_psoc4_sar__SAR_CHAN_CONFIG10 EQU CYREG_SAR_CHAN_CONFIG10
ADC_SAR_Seq_1_cy_psoc4_sar__SAR_CHAN_CONFIG11 EQU CYREG_SAR_CHAN_CONFIG11
ADC_SAR_Seq_1_cy_psoc4_sar__SAR_CHAN_CONFIG12 EQU CYREG_SAR_CHAN_CONFIG12
ADC_SAR_Seq_1_cy_psoc4_sar__SAR_CHAN_CONFIG13 EQU CYREG_SAR_CHAN_CONFIG13
ADC_SAR_Seq_1_cy_psoc4_sar__SAR_CHAN_CONFIG14 EQU CYREG_SAR_CHAN_CONFIG14
ADC_SAR_Seq_1_cy_psoc4_sar__SAR_CHAN_CONFIG15 EQU CYREG_SAR_CHAN_CONFIG15
ADC_SAR_Seq_1_cy_psoc4_sar__SAR_CHAN_EN EQU CYREG_SAR_CHAN_EN
ADC_SAR_Seq_1_cy_psoc4_sar__SAR_CHAN_RESULT_VALID EQU CYREG_SAR_CHAN_RESULT_VALID
ADC_SAR_Seq_1_cy_psoc4_sar__SAR_CHAN_RESULT00 EQU CYREG_SAR_CHAN_RESULT0
ADC_SAR_Seq_1_cy_psoc4_sar__SAR_CHAN_RESULT01 EQU CYREG_SAR_CHAN_RESULT1
ADC_SAR_Seq_1_cy_psoc4_sar__SAR_CHAN_RESULT02 EQU CYREG_SAR_CHAN_RESULT2
ADC_SAR_Seq_1_cy_psoc4_sar__SAR_CHAN_RESULT03 EQU CYREG_SAR_CHAN_RESULT3
ADC_SAR_Seq_1_cy_psoc4_sar__SAR_CHAN_RESULT04 EQU CYREG_SAR_CHAN_RESULT4
ADC_SAR_Seq_1_cy_psoc4_sar__SAR_CHAN_RESULT05 EQU CYREG_SAR_CHAN_RESULT5
ADC_SAR_Seq_1_cy_psoc4_sar__SAR_CHAN_RESULT06 EQU CYREG_SAR_CHAN_RESULT6
ADC_SAR_Seq_1_cy_psoc4_sar__SAR_CHAN_RESULT07 EQU CYREG_SAR_CHAN_RESULT7
ADC_SAR_Seq_1_cy_psoc4_sar__SAR_CHAN_RESULT08 EQU CYREG_SAR_CHAN_RESULT8
ADC_SAR_Seq_1_cy_psoc4_sar__SAR_CHAN_RESULT09 EQU CYREG_SAR_CHAN_RESULT9
ADC_SAR_Seq_1_cy_psoc4_sar__SAR_CHAN_RESULT10 EQU CYREG_SAR_CHAN_RESULT10
ADC_SAR_Seq_1_cy_psoc4_sar__SAR_CHAN_RESULT11 EQU CYREG_SAR_CHAN_RESULT11
ADC_SAR_Seq_1_cy_psoc4_sar__SAR_CHAN_RESULT12 EQU CYREG_SAR_CHAN_RESULT12
ADC_SAR_Seq_1_cy_psoc4_sar__SAR_CHAN_RESULT13 EQU CYREG_SAR_CHAN_RESULT13
ADC_SAR_Seq_1_cy_psoc4_sar__SAR_CHAN_RESULT14 EQU CYREG_SAR_CHAN_RESULT14
ADC_SAR_Seq_1_cy_psoc4_sar__SAR_CHAN_RESULT15 EQU CYREG_SAR_CHAN_RESULT15
ADC_SAR_Seq_1_cy_psoc4_sar__SAR_CHAN_WORK_VALID EQU CYREG_SAR_CHAN_WORK_VALID
ADC_SAR_Seq_1_cy_psoc4_sar__SAR_CHAN_WORK00 EQU CYREG_SAR_CHAN_WORK0
ADC_SAR_Seq_1_cy_psoc4_sar__SAR_CHAN_WORK01 EQU CYREG_SAR_CHAN_WORK1
ADC_SAR_Seq_1_cy_psoc4_sar__SAR_CHAN_WORK02 EQU CYREG_SAR_CHAN_WORK2
ADC_SAR_Seq_1_cy_psoc4_sar__SAR_CHAN_WORK03 EQU CYREG_SAR_CHAN_WORK3
ADC_SAR_Seq_1_cy_psoc4_sar__SAR_CHAN_WORK04 EQU CYREG_SAR_CHAN_WORK4
ADC_SAR_Seq_1_cy_psoc4_sar__SAR_CHAN_WORK05 EQU CYREG_SAR_CHAN_WORK5
ADC_SAR_Seq_1_cy_psoc4_sar__SAR_CHAN_WORK06 EQU CYREG_SAR_CHAN_WORK6
ADC_SAR_Seq_1_cy_psoc4_sar__SAR_CHAN_WORK07 EQU CYREG_SAR_CHAN_WORK7
ADC_SAR_Seq_1_cy_psoc4_sar__SAR_CHAN_WORK08 EQU CYREG_SAR_CHAN_WORK8
ADC_SAR_Seq_1_cy_psoc4_sar__SAR_CHAN_WORK09 EQU CYREG_SAR_CHAN_WORK9
ADC_SAR_Seq_1_cy_psoc4_sar__SAR_CHAN_WORK10 EQU CYREG_SAR_CHAN_WORK10
ADC_SAR_Seq_1_cy_psoc4_sar__SAR_CHAN_WORK11 EQU CYREG_SAR_CHAN_WORK11
ADC_SAR_Seq_1_cy_psoc4_sar__SAR_CHAN_WORK12 EQU CYREG_SAR_CHAN_WORK12
ADC_SAR_Seq_1_cy_psoc4_sar__SAR_CHAN_WORK13 EQU CYREG_SAR_CHAN_WORK13
ADC_SAR_Seq_1_cy_psoc4_sar__SAR_CHAN_WORK14 EQU CYREG_SAR_CHAN_WORK14
ADC_SAR_Seq_1_cy_psoc4_sar__SAR_CHAN_WORK15 EQU CYREG_SAR_CHAN_WORK15
ADC_SAR_Seq_1_cy_psoc4_sar__SAR_CTRL EQU CYREG_SAR_CTRL
ADC_SAR_Seq_1_cy_psoc4_sar__SAR_DFT_CTRL EQU CYREG_SAR_DFT_CTRL
ADC_SAR_Seq_1_cy_psoc4_sar__SAR_INTR EQU CYREG_SAR_INTR
ADC_SAR_Seq_1_cy_psoc4_sar__SAR_INTR_CAUSE EQU CYREG_SAR_INTR_CAUSE
ADC_SAR_Seq_1_cy_psoc4_sar__SAR_INTR_MASK EQU CYREG_SAR_INTR_MASK
ADC_SAR_Seq_1_cy_psoc4_sar__SAR_INTR_MASKED EQU CYREG_SAR_INTR_MASKED
ADC_SAR_Seq_1_cy_psoc4_sar__SAR_INTR_SET EQU CYREG_SAR_INTR_SET
ADC_SAR_Seq_1_cy_psoc4_sar__SAR_MUX_SWITCH_CLEAR0 EQU CYREG_SAR_MUX_SWITCH_CLEAR0
ADC_SAR_Seq_1_cy_psoc4_sar__SAR_MUX_SWITCH_CLEAR1 EQU CYREG_SAR_MUX_SWITCH_CLEAR1
ADC_SAR_Seq_1_cy_psoc4_sar__SAR_MUX_SWITCH_HW_CTRL EQU CYREG_SAR_MUX_SWITCH_HW_CTRL
ADC_SAR_Seq_1_cy_psoc4_sar__SAR_MUX_SWITCH_STATUS EQU CYREG_SAR_MUX_SWITCH_STATUS
ADC_SAR_Seq_1_cy_psoc4_sar__SAR_MUX_SWITCH0 EQU CYREG_SAR_MUX_SWITCH0
ADC_SAR_Seq_1_cy_psoc4_sar__SAR_MUX_SWITCH1 EQU CYREG_SAR_MUX_SWITCH1
ADC_SAR_Seq_1_cy_psoc4_sar__SAR_NUMBER EQU 0
ADC_SAR_Seq_1_cy_psoc4_sar__SAR_PUMP_CTRL EQU CYREG_SAR_PUMP_CTRL
ADC_SAR_Seq_1_cy_psoc4_sar__SAR_RANGE_COND EQU CYREG_SAR_RANGE_COND
ADC_SAR_Seq_1_cy_psoc4_sar__SAR_RANGE_INTR EQU CYREG_SAR_RANGE_INTR
ADC_SAR_Seq_1_cy_psoc4_sar__SAR_RANGE_INTR_MASK EQU CYREG_SAR_RANGE_INTR_MASK
ADC_SAR_Seq_1_cy_psoc4_sar__SAR_RANGE_INTR_MASKED EQU CYREG_SAR_RANGE_INTR_MASKED
ADC_SAR_Seq_1_cy_psoc4_sar__SAR_RANGE_INTR_SET EQU CYREG_SAR_RANGE_INTR_SET
ADC_SAR_Seq_1_cy_psoc4_sar__SAR_RANGE_THRES EQU CYREG_SAR_RANGE_THRES
ADC_SAR_Seq_1_cy_psoc4_sar__SAR_SAMPLE_CTRL EQU CYREG_SAR_SAMPLE_CTRL
ADC_SAR_Seq_1_cy_psoc4_sar__SAR_SAMPLE_TIME01 EQU CYREG_SAR_SAMPLE_TIME01
ADC_SAR_Seq_1_cy_psoc4_sar__SAR_SAMPLE_TIME23 EQU CYREG_SAR_SAMPLE_TIME23
ADC_SAR_Seq_1_cy_psoc4_sar__SAR_SATURATE_INTR EQU CYREG_SAR_SATURATE_INTR
ADC_SAR_Seq_1_cy_psoc4_sar__SAR_SATURATE_INTR_MASK EQU CYREG_SAR_SATURATE_INTR_MASK
ADC_SAR_Seq_1_cy_psoc4_sar__SAR_SATURATE_INTR_MASKED EQU CYREG_SAR_SATURATE_INTR_MASKED
ADC_SAR_Seq_1_cy_psoc4_sar__SAR_SATURATE_INTR_SET EQU CYREG_SAR_SATURATE_INTR_SET
ADC_SAR_Seq_1_cy_psoc4_sar__SAR_START_CTRL EQU CYREG_SAR_START_CTRL
ADC_SAR_Seq_1_cy_psoc4_sar__SAR_STATUS EQU CYREG_SAR_STATUS
ADC_SAR_Seq_1_cy_psoc4_sar__SAR_WOUNDING EQU CYREG_SAR_WOUNDING
ADC_SAR_Seq_1_intClock__CTRL_REGISTER EQU CYREG_PERI_PCLK_CTL10
ADC_SAR_Seq_1_intClock__DIV_ID EQU 0x00000041
ADC_SAR_Seq_1_intClock__DIV_REGISTER EQU CYREG_PERI_DIV_16_CTL1
ADC_SAR_Seq_1_intClock__PA_DIV_ID EQU 0x000000FF
ADC_SAR_Seq_1_IRQ__INTC_CLR_EN_REG EQU CYREG_CM0_ICER
ADC_SAR_Seq_1_IRQ__INTC_CLR_PD_REG EQU CYREG_CM0_ICPR
ADC_SAR_Seq_1_IRQ__INTC_MASK EQU 0x20000
ADC_SAR_Seq_1_IRQ__INTC_NUMBER EQU 17
ADC_SAR_Seq_1_IRQ__INTC_PRIOR_MASK EQU 0xC000
ADC_SAR_Seq_1_IRQ__INTC_PRIOR_NUM EQU 3
ADC_SAR_Seq_1_IRQ__INTC_PRIOR_REG EQU CYREG_CM0_IPR4
ADC_SAR_Seq_1_IRQ__INTC_SET_EN_REG EQU CYREG_CM0_ISER
ADC_SAR_Seq_1_IRQ__INTC_SET_PD_REG EQU CYREG_CM0_ISPR

; Miscellaneous
CYDEV_BCLK__HFCLK__HZ EQU 48000000
CYDEV_BCLK__HFCLK__KHZ EQU 48000
CYDEV_BCLK__HFCLK__MHZ EQU 48
CYDEV_BCLK__SYSCLK__HZ EQU 48000000
CYDEV_BCLK__SYSCLK__KHZ EQU 48000
CYDEV_BCLK__SYSCLK__MHZ EQU 48
CYDEV_CHIP_DIE_LEOPARD EQU 1
CYDEV_CHIP_DIE_PSOC4A EQU 18
CYDEV_CHIP_DIE_PSOC5LP EQU 2
CYDEV_CHIP_DIE_PSOC5TM EQU 3
CYDEV_CHIP_DIE_TMA4 EQU 4
CYDEV_CHIP_DIE_UNKNOWN EQU 0
CYDEV_CHIP_FAMILY_FM0P EQU 5
CYDEV_CHIP_FAMILY_FM3 EQU 6
CYDEV_CHIP_FAMILY_FM4 EQU 7
CYDEV_CHIP_FAMILY_PSOC3 EQU 1
CYDEV_CHIP_FAMILY_PSOC4 EQU 2
CYDEV_CHIP_FAMILY_PSOC5 EQU 3
CYDEV_CHIP_FAMILY_PSOC6 EQU 4
CYDEV_CHIP_FAMILY_UNKNOWN EQU 0
CYDEV_CHIP_FAMILY_USED EQU CYDEV_CHIP_FAMILY_PSOC4
CYDEV_CHIP_JTAG_ID EQU 0x101311A0
CYDEV_CHIP_MEMBER_3A EQU 1
CYDEV_CHIP_MEMBER_4A EQU 18
CYDEV_CHIP_MEMBER_4D EQU 13
CYDEV_CHIP_MEMBER_4E EQU 6
CYDEV_CHIP_MEMBER_4F EQU 19
CYDEV_CHIP_MEMBER_4G EQU 4
CYDEV_CHIP_MEMBER_4H EQU 17
CYDEV_CHIP_MEMBER_4I EQU 23
CYDEV_CHIP_MEMBER_4J EQU 14
CYDEV_CHIP_MEMBER_4K EQU 15
CYDEV_CHIP_MEMBER_4L EQU 22
CYDEV_CHIP_MEMBER_4M EQU 21
CYDEV_CHIP_MEMBER_4N EQU 10
CYDEV_CHIP_MEMBER_4O EQU 7
CYDEV_CHIP_MEMBER_4P EQU 20
CYDEV_CHIP_MEMBER_4Q EQU 12
CYDEV_CHIP_MEMBER_4R EQU 8
CYDEV_CHIP_MEMBER_4S EQU 11
CYDEV_CHIP_MEMBER_4T EQU 9
CYDEV_CHIP_MEMBER_4U EQU 5
CYDEV_CHIP_MEMBER_4V EQU 16
CYDEV_CHIP_MEMBER_5A EQU 3
CYDEV_CHIP_MEMBER_5B EQU 2
CYDEV_CHIP_MEMBER_6A EQU 24
CYDEV_CHIP_MEMBER_FM3 EQU 28
CYDEV_CHIP_MEMBER_FM4 EQU 29
CYDEV_CHIP_MEMBER_PDL_FM0P_TYPE1 EQU 25
CYDEV_CHIP_MEMBER_PDL_FM0P_TYPE2 EQU 26
CYDEV_CHIP_MEMBER_PDL_FM0P_TYPE3 EQU 27
CYDEV_CHIP_MEMBER_UNKNOWN EQU 0
CYDEV_CHIP_MEMBER_USED EQU CYDEV_CHIP_MEMBER_4L
CYDEV_CHIP_DIE_EXPECT EQU CYDEV_CHIP_MEMBER_USED
CYDEV_CHIP_DIE_ACTUAL EQU CYDEV_CHIP_DIE_EXPECT
CYDEV_CHIP_REV_LEOPARD_ES1 EQU 0
CYDEV_CHIP_REV_LEOPARD_ES2 EQU 1
CYDEV_CHIP_REV_LEOPARD_ES3 EQU 3
CYDEV_CHIP_REV_LEOPARD_PRODUCTION EQU 3
CYDEV_CHIP_REV_PSOC4A_ES0 EQU 17
CYDEV_CHIP_REV_PSOC4A_PRODUCTION EQU 17
CYDEV_CHIP_REV_PSOC5LP_ES0 EQU 0
CYDEV_CHIP_REV_PSOC5LP_PRODUCTION EQU 0
CYDEV_CHIP_REV_PSOC5TM_ES0 EQU 0
CYDEV_CHIP_REV_PSOC5TM_ES1 EQU 1
CYDEV_CHIP_REV_PSOC5TM_PRODUCTION EQU 1
CYDEV_CHIP_REV_TMA4_ES EQU 17
CYDEV_CHIP_REV_TMA4_ES2 EQU 33
CYDEV_CHIP_REV_TMA4_PRODUCTION EQU 17
CYDEV_CHIP_REVISION_3A_ES1 EQU 0
CYDEV_CHIP_REVISION_3A_ES2 EQU 1
CYDEV_CHIP_REVISION_3A_ES3 EQU 3
CYDEV_CHIP_REVISION_3A_PRODUCTION EQU 3
CYDEV_CHIP_REVISION_4A_ES0 EQU 17
CYDEV_CHIP_REVISION_4A_PRODUCTION EQU 17
CYDEV_CHIP_REVISION_4D_PRODUCTION EQU 0
CYDEV_CHIP_REVISION_4E_CCG2_NO_USBPD EQU 0
CYDEV_CHIP_REVISION_4E_PRODUCTION EQU 0
CYDEV_CHIP_REVISION_4F_PRODUCTION EQU 0
CYDEV_CHIP_REVISION_4F_PRODUCTION_256DMA EQU 0
CYDEV_CHIP_REVISION_4F_PRODUCTION_256K EQU 0
CYDEV_CHIP_REVISION_4G_ES EQU 17
CYDEV_CHIP_REVISION_4G_ES2 EQU 33
CYDEV_CHIP_REVISION_4G_PRODUCTION EQU 17
CYDEV_CHIP_REVISION_4H_PRODUCTION EQU 0
CYDEV_CHIP_REVISION_4I_PRODUCTION EQU 0
CYDEV_CHIP_REVISION_4J_PRODUCTION EQU 0
CYDEV_CHIP_REVISION_4K_PRODUCTION EQU 0
CYDEV_CHIP_REVISION_4L_PRODUCTION EQU 0
CYDEV_CHIP_REVISION_4M_PRODUCTION EQU 0
CYDEV_CHIP_REVISION_4N_PRODUCTION EQU 0
CYDEV_CHIP_REVISION_4O_PRODUCTION EQU 0
CYDEV_CHIP_REVISION_4P_PRODUCTION EQU 0
CYDEV_CHIP_REVISION_4Q_PRODUCTION EQU 0
CYDEV_CHIP_REVISION_4R_PRODUCTION EQU 0
CYDEV_CHIP_REVISION_4S_PRODUCTION EQU 0
CYDEV_CHIP_REVISION_4T_PRODUCTION EQU 0
CYDEV_CHIP_REVISION_4U_PRODUCTION EQU 0
CYDEV_CHIP_REVISION_4V_PRODUCTION EQU 0
CYDEV_CHIP_REVISION_5A_ES0 EQU 0
CYDEV_CHIP_REVISION_5A_ES1 EQU 1
CYDEV_CHIP_REVISION_5A_PRODUCTION EQU 1
CYDEV_CHIP_REVISION_5B_ES0 EQU 0
CYDEV_CHIP_REVISION_5B_PRODUCTION EQU 0
CYDEV_CHIP_REVISION_6A_ES EQU 17
CYDEV_CHIP_REVISION_6A_NO_UDB EQU 33
CYDEV_CHIP_REVISION_6A_PRODUCTION EQU 33
CYDEV_CHIP_REVISION_FM3_PRODUCTION EQU 0
CYDEV_CHIP_REVISION_FM4_PRODUCTION EQU 0
CYDEV_CHIP_REVISION_PDL_FM0P_TYPE1_PRODUCTION EQU 0
CYDEV_CHIP_REVISION_PDL_FM0P_TYPE2_PRODUCTION EQU 0
CYDEV_CHIP_REVISION_PDL_FM0P_TYPE3_PRODUCTION EQU 0
CYDEV_CHIP_REVISION_USED EQU CYDEV_CHIP_REVISION_4L_PRODUCTION
CYDEV_CHIP_REV_EXPECT EQU CYDEV_CHIP_REVISION_USED
CYDEV_CONFIG_READ_ACCELERATOR EQU 1
CYDEV_CONFIG_UNUSED_IO_AllowButWarn EQU 0
CYDEV_CONFIG_UNUSED_IO_AllowWithInfo EQU 1
CYDEV_CONFIG_UNUSED_IO_Disallowed EQU 2
CYDEV_CONFIG_UNUSED_IO EQU CYDEV_CONFIG_UNUSED_IO_Disallowed
CYDEV_CONFIGURATION_COMPRESSED EQU 1
CYDEV_CONFIGURATION_MODE_COMPRESSED EQU 0
CYDEV_CONFIGURATION_MODE EQU CYDEV_CONFIGURATION_MODE_COMPRESSED
CYDEV_CONFIGURATION_MODE_DMA EQU 2
CYDEV_CONFIGURATION_MODE_UNCOMPRESSED EQU 1
CYDEV_DEBUG_PROTECT_KILL EQU 4
CYDEV_DEBUG_PROTECT_OPEN EQU 1
CYDEV_DEBUG_PROTECT EQU CYDEV_DEBUG_PROTECT_OPEN
CYDEV_DEBUG_PROTECT_PROTECTED EQU 2
CYDEV_DEBUGGING_DPS_Disable EQU 3
CYDEV_DEBUGGING_DPS_SWD EQU 2
CYDEV_DEBUGGING_DPS EQU CYDEV_DEBUGGING_DPS_SWD
CYDEV_DEBUGGING_ENABLE EQU 1
CYDEV_DFT_SELECT_CLK0 EQU 8
CYDEV_DFT_SELECT_CLK1 EQU 9
CYDEV_DMA_CHANNELS_AVAILABLE EQU 32
CYDEV_HEAP_SIZE EQU 0x80
CYDEV_IMO_TRIMMED_BY_USB EQU 0
CYDEV_IMO_TRIMMED_BY_WCO EQU 0
CYDEV_INTR_NUMBER_DMA EQU 14
CYDEV_IS_EXPORTING_CODE EQU 0
CYDEV_IS_IMPORTING_CODE EQU 0
CYDEV_PROJ_TYPE EQU 0
CYDEV_PROJ_TYPE_BOOTLOADER EQU 1
CYDEV_PROJ_TYPE_LAUNCHER EQU 5
CYDEV_PROJ_TYPE_LOADABLE EQU 2
CYDEV_PROJ_TYPE_LOADABLEANDBOOTLOADER EQU 4
CYDEV_PROJ_TYPE_MULTIAPPBOOTLOADER EQU 3
CYDEV_PROJ_TYPE_STANDARD EQU 0
CYDEV_STACK_SIZE EQU 0x0800
CYDEV_USE_BUNDLED_CMSIS EQU 1
CYDEV_VARIABLE_VDDA EQU 1
CYDEV_VBUS_MV EQU 5000
CYDEV_VDDA_MV EQU 3300
CYDEV_VDDD_MV EQU 3300
CYDEV_VDDIO_MV EQU 3300
CYDEV_WDT_GENERATE_ISR EQU 1
CYIPBLOCK_m0s8can_VERSION EQU 1
CYIPBLOCK_m0s8cpussv2_VERSION EQU 1
CYIPBLOCK_m0s8csd_VERSION EQU 1
CYIPBLOCK_m0s8ioss_VERSION EQU 1
CYIPBLOCK_m0s8lcd_VERSION EQU 2
CYIPBLOCK_m0s8lpcomp_VERSION EQU 2
CYIPBLOCK_m0s8peri_VERSION EQU 1
CYIPBLOCK_m0s8scb_VERSION EQU 2
CYIPBLOCK_m0s8srssv2_VERSION EQU 2
CYIPBLOCK_m0s8tcpwm_VERSION EQU 2
CYIPBLOCK_m0s8udb_VERSION EQU 1
CYIPBLOCK_m0s8usbdss_VERSION EQU 2
CYIPBLOCK_m0s8wco_VERSION EQU 1
CYIPBLOCK_s8pass4al_VERSION EQU 1
DMA_CHANNELS_USED__MASK EQU 0
CYDEV_BOOTLOADER_ENABLE EQU 0
    ENDIF
    END
